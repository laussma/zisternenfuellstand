/*
  ESP32 Brunnen-Füllstand – Revision 2.5
  -------------------------------------------------
  Änderungen gegenüber vorher:
    * Entfernt: physischer Button / Lockout-Mechanismen (stopTryingSTA, staFailCount etc.)
    * Neuer Ablauf: Nach jedem Boot läuft der Access Point garantiert 10 Minuten (Grace Period), unabhängig von WLAN-Status.
      Danach: AP wird abgeschaltet, wenn STA erfolgreich verbunden ist; bei fehlender STA-Verbindung bleibt oder wird AP wieder aktiv.
  Features:
    * AP für Setup (CONFIG_AP / 12345678)
    * Heim-WLAN-Konfiguration + persistente Speicherung
    * AP bleibt 10 Minuten nach Start aktiv, danach nur wenn kein STA verfügbar ist
    * mDNS (zisterne.local) nach erfolgreichem STA-Connect
    * Ultraschall-Sensor (Trig GPIO16, Echo GPIO4 über Spannungsteiler) mit Median + Prozent
    * Kalibrierung (Leer/Voll) per Button oder manuell, persistent
    * HTTP-WebUI + JSON-API (/api/status) wenn Publishing aktiviert
    * Optional: Füllstand in % auf analogem DAC (GPIO25) ausgeben
*/

#include <WiFi.h>
#include <WebServer.h>
#include <Preferences.h>
#include <ESPmDNS.h>
#include <ArduinoOTA.h>
#include <Update.h>
#include <HTTPClient.h>
#include <HTTPUpdate.h>
#include <WiFiClientSecure.h>

// ---------- Konfiguration -----------------------
#define PIN_TRIG 16
#define PIN_ECHO 4
#define SAMPLES 20
#define ULTRASONIC_TIMEOUT 30000UL // 30ms ~ 5m
#define SENSOR_MIN_CM      27.0f   // JSN-SR04T Blindzone: unter 27cm keine valide Messung
#define MEASURE_INTERVAL 2000UL    // ms
#define MAX_JUMP_CM        30.0f   // groesster plausibler Sprung zwischen 2 Messzyklen
#define MEASURE_STALE_MS   30000UL // ohne gueltige Messung danach Anzeige auf "--" zuruecksetzen
#define AP_SSID "CONFIG_ZISTERNE_AP"
#define AP_PASS "12345678"
#define MDNS_HOST "zisterne"
#define STA_TIMEOUT 10000UL
const unsigned long STA_RETRY_INTERVAL = 4*15000UL; // alle 2min prüfen
const unsigned long AP_GRACE_PERIOD = 10 * 60 * 1000UL; // 10 Minuten
#define FW_VERSION "2.8"

// ---------- OTA / Update -----------------------
#define OTA_ARDUINO_PASS  "zisternenfuellstand"   // Passwort für Arduino-IDE OTA
#define OTA_WEB_USER      "admin"                 // Benutzername Web-OTA
#define OTA_WEB_PASS      "zisternenfuellstand"   // Passwort Web-OTA
#define OTA_VERSION_URL   "https://github.com/laussma/zisternenfuellstand/releases/latest/download/version.txt"
#define OTA_FIRMWARE_URL  "https://github.com/laussma/zisternenfuellstand/releases/latest/download/firmware.bin"
#define OTA_CHECK_INTERVAL (3600000UL) // Alle 60 Minuten auf Updates prüfen

// ---------- Hardware für analogen Ausgang --------
#define DAC_PIN 25 // GPIO25 = DAC1 auf ESP32

// ---------- Globals ----------------------------
Preferences prefs;
WebServer server(80);
String sta_ssid;
String sta_pass;

float d_leer = NAN;
float d_voll = NAN;
bool publishEnabled = false;
bool analogOutputEnabled = false; // Füllstand auf analogem DAC ausgeben (0..3.3V)
bool staEnabled = false;

float lastDist = NAN;
float lastPerc = NAN;
bool autoUpdateEnabled = false;
bool mdnsStarted = false;

// ISR-basierte Echo-Messung (WiFi-Interrupt-sicher)
volatile uint32_t g_echoStart = 0;
volatile uint32_t g_echoDur   = 0;
volatile bool     g_echoReady = false;
// Debug-Zähler: unterscheiden "keine Flanken" (Verkabelung/Versorgung) von
// "Flanken da, aber als Störpulse verworfen" (Blindzone/Resonanz)
volatile uint32_t g_isrRising   = 0;  // steigende Flanken gesamt
volatile uint32_t g_isrFalling  = 0;  // fallende Flanken gesamt
volatile uint32_t g_isrRejected = 0;  // zu kurze Pulse (< Blindzone) verworfen
volatile uint32_t g_lastRejectedUs = 0; // Dauer des letzten verworfenen Pulses

void IRAM_ATTR echoISR() {
  if (REG_READ(GPIO_IN_REG) & (1UL << PIN_ECHO)) {
    g_isrRising++;
    g_echoStart = micros();
    g_echoReady = false;
  } else {
    g_isrFalling++;
    if (g_echoStart > 0) {
      uint32_t dur = micros() - g_echoStart;
      // Nur Pulse >= Blindzone akzeptieren (filtert Störflanken)
      if (dur >= (uint32_t)(SENSOR_MIN_CM * 58UL)) {
        g_echoDur   = dur;
        g_echoReady = true;
      }
      // Zu kurze Pulse: g_echoStart reset damit nächste Flanke neu startet
      else {
        g_isrRejected++;
        g_lastRejectedUs = dur;
        g_echoStart = 0;
      }
    }
  }
}

uint32_t g_lastSamples[SAMPLES]; // für Debug-Endpoint
uint8_t  g_lastValidCount = 0;   // gültige Echos im letzten Messzyklus (Debug)
uint8_t  g_lastClusterLen = 0;   // Größe des Gewinner-Clusters im letzten Zyklus (Debug)

unsigned long lastMeasure = 0;
unsigned long lastGoodMeasure = 0; // millis der letzten gueltigen Messung (Staleness-Erkennung)
unsigned long lastSTAcheck = 0;
unsigned long apExpires = 0; // Timestamp bis wann AP garantiert an ist
unsigned long lastOTACheck = 0;
float diameter = NAN;
float volume = NAN;

const String logoBase64 = "/9j/4AAQSkZJRgABAQAASABIAAD/4QCMRXhpZgAATU0AKgAAAAgABQESAAMAAAABAAEAAAEaAAUAAAABAAAASgEbAAUAAAABAAAAUgEoAAMAAAABAAIAAIdpAAQAAAABAAAAWgAAAAAAAABIAAAAAQAAAEgAAAABAAOgAQADAAAAAf//AACgAgAEAAAAAQAAA0qgAwAEAAAAAQAAAWQAAAAA/+0AOFBob3Rvc2hvcCAzLjAAOEJJTQQEAAAAAAAAOEJJTQQlAAAAAAAQ1B2M2Y8AsgTpgAmY7PhCfv/iAdtJQ0NfUFJPRklMRQABAQAAAcsAAAAAAkAAAG1udHJSR0IgWFlaIAAAAAAAAAAAAAAAAGFjc3AAAAAAAAAAAAAAAAAAAAAAAAAAAAAAAAAAAAAAAAD21gABAAAAANMtUXQFDwAAAAAAAAAAAAAAAAAAAAAAAAAAAAAAAAAAAAAAAAAAAAAAAAAAAAAAAAAAAAAACXJYWVoAAADwAAAAFGdYWVoAAAEEAAAAFGJYWVoAAAEYAAAAFHd0cHQAAAEsAAAAFGNwcnQAAAFAAAAADHJUUkMAAAFMAAAAIGdUUkMAAAFMAAAAIGJUUkMAAAFMAAAAIGRlc2MAAAFsAAAAX1hZWiAAAAAAAABvnwAAOPQAAAORWFlaIAAAAAAAAGKWAAC3hwAAGNxYWVogAAAAAAAAJKEAAA+FAAC201hZWiAAAAAAAADzTwABAAAAARbCdGV4dAAAAABOL0EAcGFyYQAAAAAAAwAAAAJmZgAA8qcAAA1ZAAAT0AAACltkZXNjAAAAAAAAAAVzUkdCAAAAAAAAAAAAAAAAAAAAAAAAAAAAAAAAAAAAAAAAAAAAAAAAAAAAAAAAAAAAAAAAAAAAAAAAAAAAAAAAAAAAAAAAAAAAAAAAAAAAAAAAAP/AABEIAWQDSgMBIgACEQEDEQH/xAAfAAABBQEBAQEBAQAAAAAAAAAAAQIDBAUGBwgJCgv/xAC1EAACAQMDAgQDBQUEBAAAAX0BAgMABBEFEiExQQYTUWEHInEUMoGRoQgjQrHBFVLR8CQzYnKCCQoWFxgZGiUmJygpKjQ1Njc4OTpDREVGR0hJSlNUVVZXWFlaY2RlZmdoaWpzdHV2d3h5eoOEhYaHiImKkpOUlZaXmJmaoqOkpaanqKmqsrO0tba3uLm6wsPExcbHyMnK0tPU1dbX2Nna4eLj5OXm5+jp6vHy8/T19vf4+fr/xAAfAQADAQEBAQEBAQEBAAAAAAAAAQIDBAUGBwgJCgv/xAC1EQACAQIEBAMEBwUEBAABAncAAQIDEQQFITEGEkFRB2FxEyIygQgUQpGhscEJIzNS8BVictEKFiQ04SXxFxgZGiYnKCkqNTY3ODk6Q0RFRkdISUpTVFVWV1hZWmNkZWZnaGlqc3R1dnd4eXqCg4SFhoeIiYqSk5SVlpeYmZqio6Slpqeoqaqys7S1tre4ubrCw8TFxsfIycrS09TV1tfY2dri4+Tl5ufo6ery8/T19vf4+fr/2wBDAAICAgICAgMCAgMEAwMDBAYEBAQEBgcGBgYGBgcIBwcHBwcHCAgICAgICAgKCgoKCgoMDAwMDA0NDQ0NDQ0NDQ3/2wBDAQICAgMDAwYDAwYOCQgJDg4ODg4ODg4ODg4ODg4ODg4ODg4ODg4ODg4ODg4ODg4ODg4ODg4ODg4ODg4ODg4ODg7/3QAEADX/2gAMAwEAAhEDEQA/AP38ooooAKKKKACiiigAoqtJLHBEZpmEcarksTgCvLda+PPwO8Oz/Ztf+InhTTZv+ed5q9lC3/fMk60Aet0V4Z/w09+zX/0VjwP/AOD7Tv8A4/R/w09+zX/0VjwP/wCD7Tv/AI/QB7nRXhn/AA09+zX/ANFY8D/+D7Tv/j9H/DT37Nf/AEVjwP8A+D7Tv/j9AHudFeGf8NPfs1/9FY8D/wDg+07/AOP0f8NPfs1/9FY8D/8Ag+07/wCP0Ae50V4Z/wANPfs1/wDRWPA//g+07/4/R/w09+zX/wBFY8D/APg+07/4/QB7nRXhn/DT37Nf/RWPA/8A4PtO/wDj9H/DT37Nf/RWPA//AIPtO/8Aj9AHudFeGf8ADT37Nf8A0VjwP/4PtO/+P13Pg74k/Dr4hwz3Hw/8U6L4nitGCXD6NfQXoiZvuiRreR9p/wB6gDuqKKKACiiigAooooAKKgkdIkMkhCIoyxNeX658dfgl4YuPsfiT4g+FdKm/5532rWUD/wDfMsq0Aer0V4d/w05+zZ/0VjwR/wCD3Tv/AI/Tf+Gnv2a/+iseB/8Awfad/wDH6APc6K8M/wCGnv2a/wDorHgf/wAH2nf/AB+j/hp79mv/AKKx4H/8H2nf/H6APc6K8M/4ae/Zr/6Kx4H/APB9p3/x+j/hp79mv/orHgf/AMH2nf8Ax+gD3OivDv8Ahpz9m3/oq/gf/wAHunf/AB+ux8NfFb4XeMiF8IeMdA1wnoNN1C2uf/RUj0AegUUUUAFFFFABRRRQAUV5F4g+PXwN8J6tPoHir4i+E9G1S0OJ7LUNXsraeM/7cMsyOv8AwIVk/wDDT37Nf/RWPA//AIPtO/8Aj9AHudFeGf8ADT37Nf8A0VjwP/4PtO/+P0f8NPfs1/8ARWPA/wD4PtO/+P0Ae50V4Z/w09+zX/0VjwP/AOD7Tv8A4/R/w09+zX/0VjwP/wCD7Tv/AI/QB7nRXhn/AA09+zX/ANFY8D/+D7Tv/j9H/DT37Nf/AEVjwP8A+D7Tv/j9AHudFeGf8NPfs1/9FY8D/wDg+07/AOP0f8NPfs1/9FY8D/8Ag+07/wCP0Ae50V4Z/wANPfs1/wDRWPA//g+07/4/R/w09+zX/wBFY8D/APg+07/4/QB7nRXhn/DT37Nf/RWPA/8A4PtO/wDj9O/4ac/Zt/6Kv4H/APB7p3/x+gD3GivO/D3xc+FPi4hfCnjTw9rJPQadqNpc/wDoqV69EoAKKKKACiiigAoorgPGXxQ+Gfw5NsvxC8W6H4YN7u+zDWb+2svN2/e8v7RIm7b320Ad/RXhn/DT37Nf/RWPA/8A4PtO/wDj9H/DT37Nf/RWPA//AIPtO/8Aj9AHudFeGf8ADT37Nf8A0VjwP/4PtO/+P0f8NPfs1/8ARWPA/wD4PtO/+P0Ae50V4Z/w09+zX/0VjwP/AOD7Tv8A4/R/w09+zX/0VjwP/wCD7Tv/AI/QB7nRXhn/AA09+zX/ANFY8D/+D7Tv/j9H/DT37Nf/AEVjwP8A+D7Tv/j9AHudFeGf8NPfs1/9FY8D/wDg+07/AOP0f8NPfs1/9FY8D/8Ag+07/wCP0Ae50V4Z/wANPfs1/wDRWPA//g+07/4/R/w09+zX/wBFY8D/APg+07/4/QB7nRXhn/DT37Nf/RWPA/8A4PtO/wDj9aem/tAfAbW7oWOi/EjwjqFy3SG11iwlk/75SctQB7BRVW2ure9hW4tZFlif7rocg1aoAKKKKACiiigAooooAKKKKACiiondY1LuQAOpNAEtFeUa18dPgl4auvsXiT4heFdJuP8AnjfatZQP/wB8yyo1Yf8Aw09+zX/0VjwP/wCD7Tv/AI/QB7nRXhn/AA09+zX/ANFY8D/+D7Tv/j9H/DT37Nf/AEVjwP8A+D7Tv/j9AHudFeGf8NPfs1/9FY8D/wDg+07/AOP0f8NPfs1/9FY8D/8Ag+07/wCP0Ae50V4Z/wANPfs1/wDRWPA//g+07/4/R/w09+zX/wBFY8D/APg+07/4/QB7nRXhn/DT37Nf/RWPA/8A4PtO/wDj9H/DT37Nf/RWPA//AIPtO/8Aj9AHudFeGf8ADT37Nf8A0VjwP/4PtO/+P0f8NPfs1/8ARWPA/wD4PtO/+P0Ae50V4Z/w09+zX/0VjwP/AOD7Tv8A4/W54Z+OPwW8a6vH4f8ABvj/AMMa/qkiM8dlpeq2V1Oyr95ljild6APV6KKKAP/Q/fyiiigAoor8YP2/f+Ck0Pwunv8A4M/Ai6W48WpmDVtbTDxac3P7qD/npd/+OrQB91ftF/to/Aj9meydfHuuC51spug0LTNs9+/u0edsK/7UrLX4T/G7/grr8fvH11Jp/wAK47fwBoxG1TGFur8/7TXEq7F/4Ai1+WOva/rXirWLvxD4j1C51TVL+Zp7q7u5Gklld/vNJI3zMzVz1AHoXjX4q/Ev4j30WofEDxTrHiS6g+WKbVrya6df+BSs9cVPeXV44a7meYgbQZGZqpUUAFFFFABRRRQAUUUUAFFFFABRRRQAV/QN/wAENP8Aj2+NH+/4e/lqlfz81/QN/wAENP8Aj2+NH+/4e/lqlAH77UUUUAFFY2ta1pXh3S7vXNdvIdP06whe4urq5dY4ookG5nkkbCqqiv50v21P+Cp/ifxpdXvw4/ZzurjQvD6M0Vz4ijaSG/u/+vf7j28f+195qAP1m/aP/b+/Z8/Zue40bX9W/t3xRBlToOjlZp43/u3Lfct/+BfN/s1+Jnxn/wCCun7RHj+V7L4ax2ngDS8bf9GC3l43+01xKm1f+AotflFPc3F5cSXV05kllYs7nklmqnQB6V40+LvxT+JLxP8AELxdrfiVoWzGdWvZ7ph+MrvXBXF5dXjA3czzEDA8xmbFUqKACiiigAooooAKKKKACr8V/exQm3iuJViPWNHYLVCigD3X4b/tIfHL4RGGL4d+N9c0S2hl837Ha3ky2sh/6aW+/wAqT8RX6Z/Bj/gsn8W/DbQ6Z8ZNCsfGFnkq17ZhbC9/4F/y6t/3wtfivRQB/ar+z9+2F8B/2l7ONvht4hQ6sI/MuNE1DbBqMX97dDuKyKv96J5F96+p6/gk8O+Itc8Ja1Z+IvDWoXGlapYSrPa3tlK0M8Tr/FHInzK1f0E/sPf8FTYvE1zp/wAJv2kLiO21OTbbWHipmVIpm/u3v8Kt/wBNuF/vf3qAP3SooooA/id/bJd5P2sPi+pJIXxpq6/+TslfMtfS37ZH/J2Hxf8A+x21j/0tmr5poAKKKKACiiigAooooAKKKKACiiigAooooA0I9RvoYjbRXEqwN1jR2C16r4C+Pfxq+FsUdr8PPG2veHbdJN/2bT764t4m/wCukcTorLXjVFAH7IfBz/gsT8cvB80Fj8WrDT/Hmnq22S4RE0+/2/3t0C/Zf/HK/a/9nj9t79n79pS3jtvA+vJZa8R8+g6qVtr8f9c42YrN/wBsmav4wK07K/vNKvIb7T5nt7i3dZYpoztZWVtystAH99NFfzr/ALGH/BVrXdGurD4cftK3T6rpkhWG18UMSbi3+9/x+951/wBr73+9X9CGmapp+t6dbaxo91De2d7ClxbXFs6yRyxSDcrxsvysrL91u9AGxX87H/BbX/kePh9/2Cn/APR81f0T1/Ox/wAFtf8AkePh9/2Cn/8AR81AH4VUUUUAFFFFABRRRQAUUUUAFFFFABRRRQAVatrm4tZPOtpHjf8AvI2DVWigDtPC3j3xv4H1b+3vBevanoepqGVbzTrqa2nG7+7JEyPX3v8ACH/gqb+1Z8MWt7PWdci8b6ZF8rW3iFPOn/8AAxdlwzf7ztX5qUUAf1Zfs7/8FVvgH8X7m08OeOw/w98QTnYi6lMsmnyN/s33yKv/AG1VK/UKOWOdBJGwZGGVYcgiv4DlZgdwr9DP2R/+ChfxY/ZovLPw7qk0/inwKCqSaNdSsWto/Wxkz+5bn7v3fagD+u2ivJfgz8aPh78evA1n8Qfhrqa6jpd2NrA/LLBKPvQzR8mORO6mvWqACiiigAr5k/aG/a1+CX7MWkpe/E/XNmoXEZez0ayXz7+52/8APOLICr/tysqf7VfFH7ev/BSHTPgJJdfCr4OyW2qePACl/eSfvLfSv9ll/wCWlz/s/wAH8VfzO+K/FviTxzr974q8Xanc6vq+pTNcXV5eSNJLLI/3mZmoA/WX41/8Fhvjb4yluNP+EWn2XgTTt2I7plW/vyv+9KvkL/3xX5j+P/jR8VvipKr/ABG8Xaz4j8uRnjXUrya4WMt/zz8132rXlVFAF2e7ubpg13M0xAwPMZmqlRRQAUUUUAFFFFABRRRQAUUUUAFFFFABX6Af8Euf+T6vhn/3Gf8A0x6hX5/1+gH/AAS5/wCT6vhn/wBxn/0x6hQB/X5RRRQB/9H9/KKK4H4nfEDQPhT4A8Q/EbxQ5XS/D1hLfz4+83lLlY1/2nbaq/7RoA/NH/gpr+2vcfAfwwvwi+HN2YvG/iS2Z7i7hfD6bZ4/1g5/1038H+zmv5eJp5p5muJyXkY7mJr074x/FLxP8aPiV4g+J3i6bz9T8QXr3b7T8sa/dihj/wCmcKYjT2FeUUAFFFFABRRRQAUUUUAFFFFABRRRQAUUUUAFFFFABX9A3/BDT/j2+NH+/wCHv5apX8/Nf0Df8ENP+Pb40f7/AIe/lqlAH77VQubm3sbeW8vJUht4UaWSSVsKqr8zMzN91Vq/X4tf8FZv2tH8BeFof2dvBF4Ytc8TQefr00f3otNdWX7N/vXP/oI/2qAPgP8A4KMft23n7QniSX4X/Da7eL4eaJcNmaNv+QrcJ/y2b/pin/LJf+BV+UlFFABRRRQAUUUUAFFFFABRRRQAUUUUAFFFFABRRRQAVIrshDIcFajooA/f7/gmN+3zdfadK/Zt+Md8ZY5jHZ+FdWm/hf7q6fMx/BYW/wCA/wB2v3+r+A63uLiznjubaQxyxNuR1+8Gr+uz/gnZ+1O37SfwVjg8SXHm+MvCPladrO9tz3C+WPJvT/18bWz/ALStQB/M9+2R/wAnYfF//sdtY/8AS2avmmvpb9sj/k7D4v8A/Y7ax/6WzV800AFFFFABRRRQAUUUUAFFFFABRRRQAUUUUAFFFFABRRRQAV+u3/BO39v2/wDgdrlr8I/ixfvN8P8AUphHa3s7Z/siVv4j/wBO3/PVf4fvV+RNFAH99ttc299bx3VpIk0MqLLHJG25WVvmVlZfvKa/nn/4La/8jx8Pv+wU/wD6Pmr37/gk1+1rL488Myfs6eOLtpdc8NW/n6DPJ1n05FVWtv8Aetv/AEH/AHa8B/4La/8AI8fD7/sFP/6PmoA/CqiiigAooooAKKKKACiiigAooooAKKKKACiiigAooooAKKKKAPq39ln9qLx5+yv8R7fxh4XmludLnkWPWNGaRlt7235+Vh08xN26KSv6/Pg98W/BPxy+H2lfEvwBeLe6Pq0e5Tn54pB/rIZF/hkRvlZa/hWr9Q/+CZ/7WM/wE+MEfgPxLchfBXjmeK2vDJ8q2l392G73f+Oy/wD2NAH9XNfmj/wUe/bK/wCGavhwvhLwVdbPH3i2B0sHQ/NY2v3ZL3/e/hi/2uf4a/QzxT4k0XwZ4b1bxh4juFtNK0Oxn1G+uH6R29tG0sr/APAVUmv4n/2j/jXrv7Qfxh8R/FPXTIh1W6b7HbMdwtrNflt4F/3I6APGL69vNUvJr+/me5url2lmmlbc7u3zMzM1ZlFFABRRRQAUUUUAFFFFABRRRQAUUUUAFFFFABRRRQAV+gH/AAS5/wCT6vhn/wBxn/0x6hX5/wBfoB/wS5/5Pq+Gf/cZ/wDTHqFAH9flFFFAH//S/fyvxk/4LN/Fm58MfBjwv8KdOdo5fGeqyXV4y/dNppqq3lt/vzzwt/wCv2br+Yb/AILLa5LqP7Sui6Wj/udI8LW0RUf35Z7if/2ZaAPx8ooooAKKKKAJFRnIVBktX1N8K/2Lv2m/jLp8WsfD/wCH+q3mn3EYmt7+6RbO1mT/AKY3F00MUn/fdfo//wAEsv2JPDvxCt2/aG+KlgL/AEqyumg8PabOoME08X3ruRf4lRvlRf73+7X9GdAH8gn/AA68/bn/AOiZ/wDlY0X/AOT6P+HXn7c//RM//Kxov/yfX9fdFAH8gn/Drz9uf/omf/lY0X/5Po/4deftz/8ARM//ACsaL/8AJ9f190UAfyCf8OvP25/+iZ/+VjRf/k+j/h15+3P/ANEz/wDKxov/AMn1/X3RQB/IJ/w68/bn/wCiZ/8AlY0X/wCT6P8Ah15+3P8A9Ez/APKxov8A8n1/X3RQB/IJ/wAOvP25/wDomf8A5WNF/wDk+j/h15+3P/0TP/ysaL/8n1/X3RQB/IJ/w68/bn/6Jn/5WNF/+T6/YH/gld+zB8bf2bLf4l/8Ln8O/wDCPyeI30j7An2u0uw4sxfed/x5zzKv+vXFfr1RQBz/AIn8RaP4P8Oar4t8QXAtNK0Wym1G+uG+7Hb28bSyuf8AdRS1fxCfHT4r6/8AHD4reJfin4nf/Ttfv5Lnyg29YYfuQW8bf884YVSNPpX9OP8AwVX+J118Of2S9V07T5JIbzxjqVtoCSR/eWJ/MuZv+AtFbMjf79fyW0AFFFFABRRRQAVq2Gl6jqdxHa6fbS3M07rFEkaMzF2+6q1+n37DP/BOnxF+0j5HxF+IM1xoPgKKbERQKLrUdn3lt2/hT/pt/wB81/SZ8KfgV8I/gdoo0L4V+FtP8PW4RUkktY83EwXp59w++eY/9dHagD+OSH9lP9p+5h86z+Efji4ib7rw6FfyKf8AgSwUf8Ml/tT/APRHPH3/AIT+p/8AyPX9vFFAH8Q//DJf7U//AERzx9/4T+p//I9H/DJf7U//AERzx9/4T+p//I9f28UUAfxD/wDDJf7U/wD0Rzx9/wCE/qf/AMj0f8Ml/tT/APRHPH3/AIT+p/8AyPX9vFFAH8RP/DJX7U//AERvx9/4T+pf/GK8q8W+BPGPgPUzo/jPRNR0G+VA5tdSt5LeUK395ZUQ1/eXXJ+LvA/g74gaO/h/x1oWneIdLlOXs9Ut4rmEn18uVXWgD+C+iv20/wCCgf8AwTYsPhRo1/8AGr4GxS/8IvbHztY0MkyNYJ/FNbt1aD1Vvu+tfiXQAUUUUAFfdP8AwT2+Pdx8Bf2l/DWq3lz9n8P+IpF0DWg7ERi3umVVlb/rjNskr4WqeJ2hkSQYypDc0AfR/wC2R/ydh8X/APsdtY/9LZq+aa7n4geKtT8ceNNY8Y63c/bNQ1q7bULycjHmTz/vJG/4E1cNQAUUUUAFe2eGf2ePj5410K38S+C/hv4u8QaRebvIv9K0i9ureXY21ts0ETo21hXidf19f8EuP+THPh1/vat/6drygD+Yn/hkv9qf/ojnj7/wn9T/APkej/hkv9qf/ojnj7/wn9T/APkev7eKKAP4h/8Ahkv9qf8A6I54+/8ACf1P/wCR6P8Ahkv9qf8A6I54+/8ACf1P/wCR6/t4ooA/iH/4ZL/an/6I54+/8J/U/wD5Ho/4ZL/an/6I54+/8J/U/wD5Hr+3iigD+If/AIZL/an/AOiOePv/AAn9T/8Akenf8MlftT4LH4OePf8AwQal/wDI9f27UUAfwZeK/Bfi3wNqj6N4v0W90S/iAZre/geFwG/vLIK5Cv7zvF/gbwZ8QdHbQPHWg6d4h01zuaz1S2huYt3rslV13V+Bf7dX/BLyz8GaNf8AxZ/Zztpn0203XOqeG8mSSGL+KWy/idU/55/e/wB6gD8JaKkZGQlXGCtR0AFFFFAHrXwZ+KviP4LfE/w98TvC8vl6h4evUukXOFlX7ssUn/TOVMq/1r9Uf+CvfjDR/iC/wh8c+H5TJpviDwwmp2bf3obpmlX/AMdxX4qV9F+PfiRceN/gb8PvC+oOpn8GTXumQ85b7PPK12rN/wADnegD50ooooAKKKKAPSfBHwk+KPxNN2Phv4P17xUbAK10NDsLm+aLd93zFgR9td3/AMMl/tT/APRHPH3/AIT+p/8AyPX63f8ABD7/AJCHxW/646X/AOhXFf0FUAfxD/8ADJf7U/8A0Rzx9/4T+p//ACPR/wAMl/tT/wDRHPH3/hP6n/8AI9f28UUAfxD/APDJf7U//RHPH3/hP6n/API9H/DJf7U//RHPH3/hP6n/API9f28UUAfxD/8ADJf7U/8A0Rzx9/4T+p//ACPR/wAMl/tT/wDRHPH3/hP6n/8AI9f28UUAfxED9kv9qf8A6I54+/8ACf1L/wCR64jxj8HPiv8ADyGGbx/4M17w0k77I/7XsLmzYt/uzolf3XVnXtnaanay6ffwx3FtcI0U0Myq6MjfKysrfeVqAP4FKK/qX/a2/wCCXPwt+Lml3nif4NWFp4N8Yxx5itrNFt9Nuiv8Lwou2Fv9pK/mT8YeD/Enw+8S6j4O8YWE2l61pU7W15Z3C7Xide1AHKUUUUAFSI7I4YdRUdFAH7efF79t4/ED/gmnoXhW61BZPGurarF4U1ZZH2zSW+mqt012uPX/AEVX/wB9q/EOrf2mT7N9l/g376qUAFFFFABRRX7E/wDBLn9jLQPjfrWofGX4nWMeoeEvDlz9isdPn+ZLvUFWORvMX+KKFWHy/wATGgD4V+FX7Hn7SPxosE1j4d+AtW1DTZV8yG/mj+y2sv8A1xuLjZE3/fVexf8ADrz9uf8A6Jn/AOVjRf8A5Pr+uq1tbfT7aOzso0hhhRYo441CoqL8qqqr91VrRoA/kE/4deftz/8ARM//ACsaL/8AJ9H/AA68/bn/AOiZ/wDlY0X/AOT6/r7ooA/kE/4deftz/wDRM/8AysaL/wDJ9H/Drz9uf/omf/lY0X/5Pr+vuigD+QT/AIdeftz/APRM/wDysaL/APJ9H/Drz9uf/omf/lY0X/5Pr+vuigD+QT/h15+3P/0TP/ysaL/8n0f8OvP25/8Aomf/AJWNF/8Ak+v6+6KAP5BP+HXn7c//AETP/wArGi//ACfR/wAOvP25/wDomf8A5WNF/wDk+v6+6KAP5BP+HXn7c/8A0TP/AMrGi/8AyfX2B+wb+wf+1N8F/wBqrwV8S/id4L/sTw/oo1I3V0dQ064x9o0y6to/ltbmZv8AWSrX9HdFABRRRQB//9P9/K/ka/4KqyOf23fHMZJ2ra6Rhf8AuF2tf1y1/L7/AMFlfD39lftMaTrEUW2PWfDFrcySessc1xbbf+/cC0AfkLRRRQAUUUUAf2Sf8E7Rog/Y0+Gn/CPZ+x/Y7zG7rv8At915v/kTdX2xX88n/BKn9tHw54L01/2ePihqEenWlxdNceHL+5bbEJZ9u6yZjwuX+ZPrX9DdABRRRQAUUUUAFFFFABRRRQAUUUUAFFFFAH4I/wDBbrxDcCx+Fvhe3lIhc6teXSL3x9jWHd/wLdX8+Nfuf/wWzO7x/wCAkHbR2P8A5HuK/DCgAooooAK+nv2SPgY/7RXx78K/DCUvHp9/dG41SZP+Wdlbo01x/us6x7U9zXzDX7nf8ESPClhefED4j+OW/wCPzS9HtdKX/rnfz+e3/j1mKAP6EPDvh/RfCWg6b4W8OWcVhpWkWsVjY2sI2pDBAqxxxqv91FUCt6iigAooooAKKKKACiiigAooooAy9R0+x1axuNL1S3S7s7uN4Z4JlV0kRl2sjK33lav4rv2tvg/D8B/2iPG3wwszmy0nUS9iCzOy2l0q3NqrM33n+zSpur+2Wv5Xf+CwFpbQ/tVmaGMLJcaJaNI/qVSgD8paKKKACiiigBzMx602iigAooooAK/r6/4Jcf8AJjnw6/3tW/8ATteV/ILX9fX/AAS4/wCTHPh1/vat/wCna8oA/QKiiigAooooAKKKKACiiigAooooA/ko/wCCmf7Otp8Bf2gLrUvDtsLfwz4zjbV9PijXZFDMzbbqBf8AgXzf8Cr82q/pL/4LX+GLK9+EvgHxdL/x9aVrd1Yw/wC7ewrI3/pKK/m0oAKKKKACr4uZBZNZtjy2kWU+uVVlqhRQAUUUUAFFFFAH75f8EPv+Qh8Vv+uOl/8AoVxX9BVfz6/8EPv+Qh8Vv+uOl/8AoVxX9BVABRRRQAUUUUAFFFFABRRRQAV+GP8AwWG/Zy07U/CmnftGaBbFNU0uWLStc2dJLWRm8iaT/cf5f+BCv3Or5d/bS8PWHib9lD4qabqsYlt4PDV5qBQ92sF+2R/+PwCgD+KWiiigAooooAKKKKACiiigAr+uf/glcNL/AOGLfBzaft+0G71L7ft/57/bZdv/AJA8qv5GK/Z7/glX+2R4a+D2p6j8D/iVexad4f8AEV0L7StQnbbFBfuscTRyH+FZtq/N/eFAH9L1FRo6yKGQ5BqSgAooooAKKKKACiiigAooooAKKKKACiiigAooooA//9T9/K/GL/gsz8KLjxL8HvC3xU09C8nhHU5LO8Cf8+uoqvzt/spPAn/fdfs7XnHxY+HOi/F74b+Jfhn4hOLDxHps2nyyBVdomlXEcyq3G+F9sif7QoA/hKor0/4t/DHxJ8HPiN4g+Gni2IRap4evZbOYr92TYfllX/pnMvzJ7GvMKACiiigB6lkIYV9j/Db9vT9rL4T6Wuh+DviFqI05FVIbbUVg1JIo0+VY4Vv0ufJX/dr41ooA/V/Q/wDgsN+1ho1qkV8nhzXJh96XUbHb/wCO2cttXqHhv/gth8ZYZceMfA3hi7i/6hgvbZv/ACLdT1+KFFAH9Adp/wAFxofu3vwdYn1h17/4rTq9j0n/AILUfAORFOv+DvE9sx6iwFtdY/7+y21fzM0UAf1ceF/+Cu37IviIH7dN4h0D/sJ2MQ/9Jrm5r1XSv+Cln7E+tXEdrZ/EmJZ5TtRJtN1SPn/eez2/rX8eVFAH9tmn/td/suaio8n4r+Ebcj+G91S2tG/75uXjavY/DPjnwT40tvtXg7xBpeuwdfM0y7hu1/76id6/gwrWg1fVLQwtBdTRm3bdDsdhsb+8tAH981FfxyfCf/goZ+1f8IbqIaR44vde08SKz6br7f2hC6f88l8/dLAv/XB46/aj9m//AIK0/B74pSW3hz4v248A67N8q3byeZpkrYP/AC2+/b/9tP8AvqgD9c6KzbO8tdRtYr+xljube5QSQzRsro6MNysrL95WrSoA/nO/4LZ/8lF8Cf8AYE/9ubivw0r9y/8Agtn/AMlF8Cf9gT/25uK/DSgAooooAK/fj/gh1/x8/F7/AK56J/6FfV+A9fvx/wAEOv8Aj5+L3/XPRP8A0K+oA/oEr408ef8ABQD9kb4Z+LNT8D+N/H8Wm65o9w1re2g0/U5zDKn3lZre0kTj/er7Lr+Jb9sb/k6/4wf9jvrP/pbNQB/Th/w89/YY/wCinJ/4Kda/+QaP+Hnv7DH/AEU5P/BTrX/yDX8flFAH9gf/AA89/YY/6Kcn/gp1r/5Bo/4ee/sMf9FOT/wU61/8g1/H5RQB/YH/AMPPf2GP+inJ/wCCnWv/AJBo/wCHnv7DH/RTk/8ABTrX/wAg1/H5RQB/YH/w89/YY/6Kcn/gp1r/AOQaP+Hnv7DH/RTk/wDBTrX/AMg1/H5RQB/YH/w89/YY/wCinJ/4Kda/+Qa/A3/gpP8AGn4YfHn4/ReNPhRra63o40q3tmuRBPb/ADov925ihevzuooAKKKKACiiigAooooAKKKKACv6+v8Aglx/yY58Ov8Ae1b/ANO15X8gtf19f8EuP+THPh1/vat/6drygD9AqKKKACiiigAooooAKKKKACiiigD8cv8AgtJ/yb34V/7GdP8A0nkr+ZCv6b/+C0n/ACb34V/7GdP/AEnkr+ZCgAooooAKKKKACiiigAooooA/fL/gh9/yEPit/wBcdL/9CuK/oKr+fX/gh9/yEPit/wBcdL/9CuK/oKoAKKKKACiiigAooooAKKKKACvnn9rT/k1v4uf9iTrX/pBNX0NXzz+1p/ya38XP+xJ1r/0gmoA/iJooooAKKKKACiu8+G1hZ6r450bS7+PzLe8uVgmX1Vq7P9oL4NeJf2f/AIs+IvhZ4nQ/adIuCIZ0Xalxbv8ANDMv+y8bUAeIUUUUAFSK7IQyHBWo6KAPrn4U/tvftQfBLR18PfDzx5f2ulRp5cFlerDfwQJu+7DDeJMsP/Aa+odB/wCCwX7WOj2qxag3h/XJx96a/sQg/wC+bNravylooA/aXw7/AMFrvjrDeD/hK/BPhK6tf7unx3tu/wD31LeTL+leuW3/AAXFAXbefB7zW/vQ65sX/wAe096/n+ooA/ph0n/gtT8CZo1bxD4N8S2hPUWBtrrH/f17avUPDX/BXz9kjxBMYb4eJtBI76nYwhf/ACXupq/lOooA/sFsP+CnH7EV/hV+I6RO3RZtM1VT/wCkdey6f+2D+y1qK7o/ir4Ttv8Ar/1GCz/9KWir+JWigD+8jwt8Rfh/44hM/gnxNo3iCP8Av6VewXa/99QO9dpX8CSXt5DGI4biVIwdwCMwUNX2H8I/2+/2p/g5JFHoXjrUNS06IoP7M1lvt9v5af8ALKNbjf8AZ1/65baAP7KqK/Gf9nX/AIK9/DLxy1t4a+O1gPBmqSDZ/atoWl0yQ/7XWe34/vbvrX7BaVq2n63p1tq2j3UN7Y3kazW9zbOskUsbjcrxyLlWVvWgDWooooAKKKKAP//V/fyiiigD8hf+CoH7GEnxo8KN8a/h3aeZ4x8N2hXULWIfNqNhH823/akt/mZP9mv5fulf391+G/7ef/BMb/hNLvUvjL+z1aBNbmzcar4ajUKly/8AFLZf3X/6Y/db+H+7QB/OXRWxqWm6jot9PpmqW0tleWjtFNBMjI8bq21lZW5VlasegAooooAKKKKACiiigAooooAKKKKACiiigD9LP2KP+ChXjv8AZs1a18JeLp7nxD8PZWVJdPd98tgOP3tl/wDGfu/Sv6mvAfjzwp8TfCmmeOfA+pQ6tourwLcWt1Acqyt/C391l+6yt8ytwa/g5r9Pv+CdP7aV9+zj4+g8D+OL3/i3fiSdUuxN93T7l/lW8T/Z/hm9v92gD6N/4LZ/8lF8Cf8AYE/9ubivw0r9zP8Agtlz8RPAeOh0T/25uK/DOgAooooAK/fj/gh1/wAfPxe/656J/wChX1fgPX78f8EOv+Pn4vf9c9E/9CvqAP6BK/iW/bG/5Ov+MH/Y76z/AOls1f201/Et+2N/ydf8YP8Asd9Z/wDS2agD5sooooAKKKKACiiigAooooAKKKKACiiigAooooAKKKKACiiigAr+vr/glx/yY58Ov97Vv/TteV/ILX9fX/BLj/kxz4df72rf+na8oA/QKiiigAooooAKKKKACiiigAooooA/HL/gtJ/yb34V/wCxnT/0nkr+ZCv6b/8AgtJ/yb34V/7GdP8A0nkr+ZCgAooooAKKKKACiiigAooooA/fL/gh9/yEPit/1x0v/wBCuK/oKr+fX/gh9/yEPit/1x0v/wBCuK/oKoAKKKKACiiigAooooAKKKKACvnn9rT/AJNb+Ln/AGJOtf8ApBNX0NXzz+1p/wAmt/Fz/sSda/8ASCagD+ImiiigAooooA9I+Ef/ACUvw5/1/pX9OP8AwUo/Ywf9o/wHH8QPAFmsvxB8KwMsEK8NqFl8zNaf7UiM26H/AGsr/FX8x3wj/wCSl+HP+v8ASv7tKAP4Ebq0urG5ktLuNoZ4WKujDBDLVGv6df2+v+Cb9t8Zpbz4v/BO3hs/GrHzdT0v5Y4dT7+YrdI7v/a/j6V/Nb4i8Oa74R1y98N+KNPudK1bTpmgu7O8jaOWJ1+8sit8ytQBzlFFFABRRRQAUUUUAFFFFABRRRQAUUUUAFfff7H37ePxL/ZY1mLSXkl8QeBrqfdfaHLJ9ze3zy2bf8sZP/HWr4EooA/uu+E/xX8DfG3wJpvxF+Hmopqei6om6KQcOjjG6KZOfLkQ/K6nvXp1fyA/sE/that+yx8TEi1mae58DeIZEg1uyT5/L5+W9ij/AOesP/jyk1/XTp+o2OsWFvqmmXEd1Z3kaTwTwsHSSNhuV1ZfvK69KANWiiigD//W/fyiiigAooooA+N/2l/2Ifgf+07avdeK9MGleIwu2HxBpixx3Y7KszY/fx/7LV+Evxs/4JLftKfDmW41HwCtn8QNHQsyvpp8m9VP+mlnL95v9mBpK/qiooA/g58T/D3x34I1j/hH/GXh3VdD1TG5rLUbWa3nC/8AXOVUeuNZGQlXGCtf306hp+n6rbNZ6nbQ3cD/AHo50V0P/AWrxe+/Zg/Zr1JzcXvwo8FzSt1lbRLDf/315G6gD+Hqiv7LvE//AAT3/Y28XTC41r4ZacZANoa0uL2z/wDSW5hrzHVf+CVP7Gd/F5en+F7/AEgetpqFxKf/ACca5oA/kfor+n+7/wCCLv7MT82HiXxpA3/TW6sJB/3z9gSvI9e/4IheFru6aXw78VrvTIf4Y7nR1usf8C+3Q0AfzuUV+5fiT/giV8RLa3P/AAh/xE0W/n9dSgubNf8AyEtzXlV7/wAEZv2o7Ndw1rwhfe1nd3P/ALXs4aAPyJor9EfEX/BLr9tDQDcXCeBl1G2gPyyWWo2EjOv+zD9p82vhrxZ4O8W+AtZl8OeNdGv9B1e3/wBdZalBJbTpu/vRyqjLQBydFFFABUiuyEMhwVqOigD6d+Lfxz1r4xfCvwBovieY3Gq+BLNtCWdzl57NWkltmb/rjG3k/hXzFRRQAUUUUAFfvx/wQ6/4+fi9/wBc9E/9Cvq/Aev34/4Idf8AHz8Xv+ueif8AoV9QB/QJX8S37Y3/ACdf8YP+x31n/wBLZq/tpr4i8bf8E7/2RviL4u1bx14x8ENf61rl1Le39x/aOow+bPK2532xXKKvzf3RQB/HBRX9fX/Drn9h3/onbf8Ag21b/wCTKP8Ah1z+w7/0Ttv/AAbat/8AJlAH8gtFf19f8Ouf2Hf+idt/4NtW/wDkyj/h1z+w7/0Ttv8Awbat/wDJlAH8gtFf19f8Ouf2Hf8Aonbf+DbVv/kyj/h1z+w7/wBE7b/wbat/8mUAfyC0V/X1/wAOuf2Hf+idt/4NtW/+TKP+HXP7Dv8A0Ttv/Btq3/yZQB/ILRX9fX/Drn9h3/onbf8Ag21b/wCTKP8Ah1z+w7/0Ttv/AAbat/8AJlAH8gtFf19f8Ouf2Hf+idt/4NtW/wDkyj/h1z+w7/0Ttv8Awbat/wDJlAH8gtFf19f8Ouf2Hf8Aonbf+DbVv/kyj/h1z+w7/wBE7b/wbat/8mUAfyC0V7x+0v4T0LwH+0F8RvBHha2+yaPoHifUtNsLfcz+VbwXMkca7mrwegAooooAK/r6/wCCXH/Jjnw6/wB7Vv8A07XlfyC1/X1/wS4/5Mc+HX+9q3/p2vKAP0CooooAKKKKACiiigAooooAKKKKAPxy/wCC0n/JvfhX/sZ0/wDSeSv5kK/pv/4LSf8AJvfhX/sZ0/8ASeSv5kKACiiigAooooAKKKKACiiigD98v+CH3/IQ+K3/AFx0v/0K4r+gqv59f+CH3/IQ+K3/AFx0v/0K4r+gqgAooooAKKKKACiiigAooooAK+ef2tP+TW/i5/2JOtf+kE1fQ1fPP7Wn/Jrfxc/7EnWv/SCagD+ImiiigAooooA9I+Ef/JS/Dn/X+lf3aV/CX8I/+Sl+HP8Ar/Sv7tKACvlD9on9jX4F/tM6aV+IGhrDrUabbbXtP/cX8X/bQcSL/sy7hX1fRQB/Ll8cP+CRvx+8A3UupfCmS38f6MRuVIStpfov91reVtrf8Bdq/NDxf8MPiT8PdQh0fx94W1jw7fXHzRW2qWc1rK//AAGVUav7vKo3tnaajbSWd/BHc28q4eKZVdCP9pWoA/gYkikhkMcilXXqDwRUFf3F6p+zP+znrcrXWsfCzwZeXD/emm0WweQ/9tPI3frXk/if/gn3+xx4wlFxrfwx0wyKNoNpNd2f/pLPDQB/GZRX9cuqf8Erf2Lr6Jo9N8I3mj7/AOK11G7lb/yclua8ZvP+CLv7L8gH2LxF41gb1e7sZB+X2FaAP5gKK/os8Sf8ERvBl9Ju8MfFG90lf7t1pS3n/t9BXlWuf8ESvHFtbSHw38SNK1G47G/tJrVf/HPtNAH4UUV+vF3/AMEYf2oLRQya74PvT/dtbu7/APa9nDXkOs/8Erv20tLkm+zeC4NQt4/uSwanp3zf9s/tO+gD85aK7vxz8PvGvw016Xwx490O/wBA1W3+Z7TUIJIJdrfdbbJ/C1cJQAUUUUAFf01f8Ehf2i38e/C6/wDgZ4kuQ+reBwtzpmfvSaXK33f+3eZtv0Za/mVr7j/4J7fFa5+Ef7WHgPVN8gstcvl0DUE3FUMGo/uN0n+zDKyTf8BoA/sZooooA//X/fyiiigAooooAKKKKACiiigAooooAKKKKACiiigAr48/bB/ZI8DftVfD260bVbW3tfFdhbv/AGBrTL+9tpfveWzdWgkb76/8Cr7DooA/gg17Q9U8M6zf+H9Zt5LW/wBOuXtriCQYdHibaystYVfRf7XMttP+1N8XprRg8TeN9aKMn3f+P+avnSgAooooAKKKKACiiigAr99f+CHjL9t+LY7mPSP/AEK8r8Cq/Tn/AIJW/GrTPhT+1DZaNr0wt9N8c2L+HxK7fJHdSyRy2v8A33LEkP8AwKgD+sOiiigAooooAKKKKACiiigAooooAKKKKACiiigAooooA/iZ/bI/5Ow+L/8A2O2sf+ls1fNNfS37ZH/J2Hxf/wCx21j/ANLZq+aaACiiigAr+vr/AIJcf8mOfDr/AHtW/wDTteV/ILX9fX/BLj/kxz4df72rf+na8oA/QKiiigAooooAKKKKACiiigAoorM1HULLSrG41LU7hLS0tY3lnnmYIkcaLuZ2ZvuqtAH4hf8ABbDxstj4Q+HXgKIqZNRvL3UZv7yLbrCkZ/76kb8q/nTr7Y/b2/aIh/aS/aH1rxbpEnmeHtJQaHobD+K0tmZvN/7bTO8n0NfE9ABRRRQAUUVaFtM0BuQv7tXCE+9AFWiiigAooooA/fL/AIIff8hD4rf9cdL/APQriv6Cq/n1/wCCH3/IQ+K3/XHS/wD0K4r+gqgAooooAKKKKACiiigAooooAK+Qf28/Gdv4D/ZD+JuuXALCfRzpgVepOoyx2P8A7Xr6+r+dr/gsL+0xZ+INU0v9nTwleCaHSJ/7R8RGI5X7XysFs3+1EuW/4FQB+FFFFFABRRRQB6f8G7eS6+Kfhe1j+/LqUSj/AIFX91tfxOfsf+G7zxX+0/8AC7RrSBpw3irTZLpR2tUuY2uG/wC/W6v7Y6ACiiigAooooAKKKKACiiigAooooAKKKKAPmz9pj9mbwB+0/wDDy68F+MrWJLyON20rVVTdPY3GPlkTn5l/vxn5Wr+Mnx14P1r4e+M9b8DeIYhDqnh/ULjTL1EbOJrWRopFDfVa/vJr+Of/AIKKXeg6h+2R8TJvDwV7ePUkgl2drqK3jju93+19p3UAfDdFFFABWxos1xb6tZXFnMbadZ0McwbBRt33qx6eoZyFFAH97XhfWofEnhrSfEVtjytUsYL1MdMTxrIv/oVb9eJfs2o8f7OvwthlBWRPBehq4PUMNPtxXttAH//Q/fyiiv59/wDgrT8fPjR8Lvjj4U8L/Dfxrr3hbTbjwpFqFxBpF7NaLJO99dw+Y3lYy22NRQB/QRRX8Sf/AA2B+1Z/0WHx1/4O7/8A+O0f8NgftWf9Fh8df+Du/wD/AI7QB/bZRX8Sf/DYH7Vn/RYfHX/g7v8A/wCO0f8ADYH7Vn/RYfHX/g7v/wD47QB/bZRX8Sf/AA2B+1Z/0WHx1/4O7/8A+O0f8NgftWf9Fh8df+Du/wD/AI7QB/bZRX8Sf/DYH7Vn/RYfHX/g7v8A/wCO0f8ADYH7Vn/RYfHX/g7v/wD47QB/bZRX8Sf/AA2B+1Z/0WHx1/4O7/8A+O0f8NgftWf9Fh8df+Du/wD/AI7QB/bZRX8Sf/DYH7Vn/RYfHX/g7v8A/wCO0f8ADYH7Vn/RYfHX/g7v/wD47QB/bZX50fty/t0+Cv2bfB2qeGPDOqW978Sr2DytO06PbL9jaUfLc3a/wonJC/xV/NFqH7V/7TuqWkum6l8WfGl1a3Csk0M2tX7I6t/Cy+bXz9NNNM26ZzI3qTmgCxe3lxf3Mt3dSGWWd2d3YksWb1LVQoooAKKKKACivtT9jj9l7Xf2nPEHi7TNIicweHvDF7eq33Vlv3h22Ft5n8O+5w3+6pr46vLSawupLS6jMMsLsjoQwYMvqGoAoUUUUAFWbe4mtZkuYGMckTbkYdmqtRQB/Sd+w/8A8FQPCvirQbH4aftG6pHo/iO0C29r4ivG22t9/wBfUn3IZ/8Ax1v9mv2bsb2z1O0h1HT547m2uUWWGaFldHRvmVlZfvK1fwLV6p4J+NXxf+G0E9r8PPG3iDw1FcvvmTR9QubPzG/2vIdN1AH91FFfxKf8NhftW/8ARYfHH/g7vv8A47Sf8NgftWf9Fh8df+Du/wD/AI7QB/bZRX8Sf/DYH7Vn/RYfHX/g7v8A/wCO0f8ADYH7Vn/RYfHX/g7v/wD47QB/bZRX8Sf/AA2B+1Z/0WHx1/4O7/8A+O0f8NgftWf9Fh8df+Du/wD/AI7QB/bZRX8Sf/DYH7Vn/RYfHX/g7v8A/wCO0f8ADYH7Vn/RYfHX/g7v/wD47QB/bZRX8Sf/AA2B+1Z/0WHx1/4O7/8A+O0f8NgftWf9Fh8df+Du/wD/AI7QB/bZRX8Sf/DYH7Vn/RYfHX/g7v8A/wCO0f8ADYH7Vn/RYfHX/g7v/wD47QB/bZRX4if8EhPjJ8V/ixe/EpPiT4v1rxSumRab9jOr3c140XmtcbtrSk/3a/bugD+Jn9sj/k7D4v8A/Y7ax/6WzV8019Lftkf8nYfF/wD7HbWP/S2avmmgAooooAK/r6/4Jcf8mOfDr/e1b/07XlfyC1/X1/wS4/5Mc+HX+9q3/p2vKAP0CoryL4965qnhb4G/EPxPoU5tNU0bwpq+oWVwv3op7eymljdf9xlFfx4n9sH9qwn/AJLD44/8Hd//APHaAP7a6K/iT/4bA/as/wCiw+Ov/B3f/wDx2j/hsD9qz/osPjr/AMHd/wD/AB2gD+2yiv4k/wDhsD9qz/osPjr/AMHd/wD/AB2j/hsD9qz/AKLD46/8Hd//APHaAP7bKK/iT/4bA/as/wCiw+Ov/B3f/wDx2hv2vP2qpFMcnxg8c/8Ag8vx/wC1aAP7HPif8ZPhd8F9BbxJ8UvE+neG7BVJQ3soEku37whhXdLM/wDsxozV/Of+3d/wUn1L482dx8LfhALrRvA0h2ahdTfu7rU1/u7f+Wdv/sn7x6+lflHr3iTxB4q1K41jxFqN1qV7dv5k893K0kjt/eZmrn6ACiiigAooooAK9y8UfD288KfBnwf4wv4/LfxheXl1bMDnzLW1ZrZW/wC/6TrXG/DbwJ4g+KHjrRPh94VtvtWqa9fw2NtETt+aVtvzN/Cv95q/Vv8A4KyfD7RPhRafB/4deHONM8PeGhp9up6nypJFaRv9p6APxkooooAKKKKAP3y/4Iff8hD4rf8AXHS//Qriv6Cq/n1/4Iff8hD4rf8AXHS//Qriv6CqACiv5Rf21v2nP2ivC/7Tvj7w54W+JvivRdLsNYuILSy0/VLu3gijilaJVWOJ8fw18m/8NgftWf8ARYfHX/g7v/8A47QB/bZRX8Sf/DYH7Vn/AEWHx1/4O7//AOO0f8NgftWf9Fh8df8Ag7v/AP47QB/bZRX8Sf8Aw2B+1Z/0WHx1/wCDu/8A/jtH/DYH7Vn/AEWHx1/4O7//AOO0Af22Vha94i0LwrpU2veJ9RtNJ0y1XfPe380dvBEv96SSVkRfxr+LD/hsD9qz/osPjr/wd3//AMdry/xp8UviR8RrqG++IHinWPEtzACscur3k944Df7U7vQB/QP+2X/wVU8MeGdL1H4e/s23I1rX5g1vN4ljKmztP+vT/n4m5/3F/wBqv5ztQ1C+1i/uNV1W4lu7y8kaaeeZmd5Hc7mZmb7zNWTRQAUUUUAFFFSKjOQqDJagD9bf+CPfwsm8XftK3PxEnt2Nl4F0eedZuwu79WtIk/79NcN+Ff1F1+c3/BMn4CS/BL9m7TtS1mNU13xu6a9eD+KOGWNfskR/3Ivm/wCBV9Z/tEa5q3hr9n/4m+I9Au5LDVNJ8H6zfWV1CfnhuILCaWKRf9pHUMKAPZqK/iT/AOGwP2rP+iw+Ov8Awd3/AP8AHaP+GwP2rP8AosPjr/wd3/8A8doA/tsor+JP/hsD9qz/AKLD46/8Hd//APHaP+GwP2rP+iw+Ov8Awd3/AP8AHaAP7bKK/iT/AOGwP2rP+iw+Ov8Awd3/AP8AHaP+GwP2rP8AosPjr/wd3/8A8doA/tsor+JP/hsD9qz/AKLD46/8Hd//APHaP+GwP2rP+iw+Ov8Awd3/AP8AHaAP7bKK/iT/AOGwP2rP+iw+Ov8Awd3/AP8AHaP+GwP2rP8AosPjr/wd3/8A8doA/tsor+JP/hsD9qz/AKLD46/8Hd//APHajm/a5/anuI2guPi944eN+qnW7/8A+O0Af1I/tgfts/Dr9l7wneRfbbTVPHU8ONL0FZFL+Y33Zbra2YYP9pq/kF8SeIdX8Wa7qPiXXrqS81HV7qW8vJ5eXlnnbzJJG/2nas2+1C81G5lvL+aSeeYlpHkOWLM25jWdQAUUUUAFdJ4V0rVNb8S6ZpOhQNc6hd3kUVtCvV3ZvlFc3X6Cf8E0vhBN8V/2svCMk0DS6b4Rf/hKLx8fc+wMrW3/AH1d+UtAH9cejaXbaLpFjo1r/qLC2itYv9yJVRf0WtWiigD/0f38r+ZH/gtd/wAnI+Dv+xIt/wD046hX9N1fzI/8Frv+TkfB3/YkW/8A6cdQoA/HGiiigAooooAKKKKACiiigAooooAKKKKACiiigAooooAKkRGdwo6mo6/Zf/gmP+w9efFPxNZ/Hn4m2Pl+ENDn36VaXKf8hG7X+Lb/AM+0Lf8AfTUAfql/wTc/Zsm/Z3+A1vceJbX7L4r8YvHqmqo/34U27bW2b/cRj3+81fjh/wAFVP2aX+EPxmf4p+H7fHhrx9NLdttPyw6lu3XSf8D+/wDjX9UVeP8Axx+DPhD4+fDPWfhj42hD2GrQsscyqpltrhVPk3MO7/lrC3zLQB/DHRX0H+0X+zx48/Zr+Il58P8AxvBkxkyWV/GMQ3dv/DNH3/OvnygAooooAKKKKACiiigAooooAKKKKACiiigAooooAKKKKAP30/4Ief8AH/8AFj/rjpP/AKFdV/QRX8+//BDz/j/+LH/XHSf/AEK6r+gigD+Jn9sj/k7D4v8A/Y7ax/6WzV8019Lftkf8nYfF/wD7HbWP/S2avmmgAooooAK/r6/4Jcf8mOfDr/e1b/07XlfyC1/X1/wS4/5Mc+HX+9q3/p2vKAPpH9pr/k2z4sf9iRr3/puuK/h0r+4v9pr/AJNs+LH/AGJGvf8ApuuK/h0oAKKKKACiiigAooooAKKKKACiiigAoor9RP8Agnp+wrrP7R3iyD4ieO7WS1+G2iz5lZ9yHUp0/wCXaH/Y7zN/wH+KgD7d/wCCSP7JJ0XT2/aa8b2u281GJ7bwvC/WOD5orm77/M/3U/4FXmf/AAW1/wCR4+H3/YKf/wBHzV/Qnp2n2elWNvpum26WlpaxpFBBCoRERV2qiqv3VWv57P8Agtr/AMjx8Pv+wU//AKPmoA/CqiiigAooooA/fL/gh9/yEPit/wBcdL/9CuK/oKr+fX/gh9/yEPit/wBcdL/9CuK/oKoA/jL/AG+v+TtviR/2HLz/ANKJa+N6+yP2+v8Ak7b4kf8AYcvP/SiWvjegAooooAKKKKACiiigAooooAKKKKACv0f/AOCc37Jr/tJfF+LWfE9iZfA3hR1vNXdx+6uZf+WFl/wP7z/7INfNf7N/7N3j/wDaa+INt4G8DQbIxtfUtTkVjb2Vvn5pZmH6L3r+w34FfBXwb+z/APDPSfhj4HhKWOmx7pp3/wBZc3DKvnXMn/TSVl3GgD2JVUDaK8J/am/5Nk+Lv/Yh6/8A+m24r3ivB/2pv+TZPi7/ANiHr/8A6bbigD+HuiiigAooooAKKKKACiiigAooooAKKKKACiiigAooooAkVGchUGS1f1Sf8Eqv2a5/g38FJPiN4otWtvEvj7yrrZMMPBpq/wDHpH/21H738Vr8qv8Agm/+xDdftCeNI/iV8QtOYfDrQJgzLKP3epXUbf8AHov96NP+W3/fP8Vf1TqqgbRQA6iiigD/0v38r+ZH/gtd/wAnI+Dv+xIt/wD046hX9N1fzL/8FrY3P7R3g2QA4/4QmBf/ACo6hQB+NdFO2N6GjY3oaAG0U7Y3oaNjehoAbRTtjeho2N6GgBtFO2N6GjY3oaAG0U7Y3oaNjehoAbRTtjeho2N6GgBtFWFhmbGxCc+1eqeE/gV8afH9t9t8DeBfEXiGDJG/S9Pubr/0Uj0AeR1IqNIdqAk1+rPwg/4JJftM+P7mG88cR6f4C0lmVjLqMiz3ZT/pnawfxf7M5jr9mv2av+CcfwC/Z3ns/EhtX8XeLrX501jV0XbC/wA3zWtqP3UH3v8Aab/aoA/KL9iH/gmL4n+KF7YfE349Wc2h+EI9txaaSTsu9R/u7tvMNt/4830r+kjRdG0nw7pVpoeg2cOn6dYQpb2tpbIscUUUa7VSNF+VVX0raooAKKKKAPnj9ov9mz4bftN+BJvBPxAtPnTdJp+pwqv2qyn/AOesLN/48v3Wr+VL9qb9iz4vfssa5L/wlFi+qeGJZdth4htIm+yS7s7Vk/54zf8ATNvwr+zSsPW9C0XxNpF14f8AEun2uq6bfRtDc2l5Es0EqN/DJG4ZWU/7VAH8D9Ff05/H3/gj/wDCHx9PNrvwb1OTwLqUmWOnyK1zpzt7Lu82H/gLN9K/J/4m/wDBMf8Aa5+GrXE8XhD/AISywgbct14dlW8aRf8AZtfkvP8AxygD87KK77xb8MviH4CuY7Pxx4Z1bQLiUErDqVpNbP8A98yolcMYZF+8poAiop2xvQ0bG9DQA2inbG9DRsb0NADaKdsb0NGxvQ0ANop2xvQ0bG9DQA2inbG9DRsb0NADaKdsb0NGxvQ0Afvl/wAEPP8Aj/8Aix/1x0n/ANCuq/oIr+fn/gh8pW8+LGf+eek/+hXVf0DUAfxM/tkf8nYfF/8A7HbWP/S2avmmvpb9sj/k7D4v/wDY7ax/6WzV800AFFFFABX9fX/BLj/kxz4df72rf+na8r+QWv6+v+CXH/Jjnw6/3tW/9O15QB9I/tNf8m2fFj/sSNe/9N1xX8Olf3G/tLQyT/s5/FS3hUs8vgnXEQDqWbTriv4dNjehoAbRTtjeho2N6GgBtFO2N6GjY3oaAG0U7Y3oaNjehoAbRWtbaXql7cra2dpNNO7eWERGZt33dtfRngv9jP8Aai8f3sen+G/hl4jk81vluri0ktrP/wADJ9lv/wCP0AfLtaFnY3epXcVlYQvNPO4jijQbmLMdqrX7MfB7/gjV8YPEL29/8X/EOm+EbPdmWzsz9vvP/kX/AMeav2b/AGff2If2eP2bYorjwH4fF5raL82u6wVutQPusmxIof8AthHHQB+PH7Gn/BKnxL4uurD4iftKW02h6CP3tv4ZdXivbr/r6+49rHj+H7/T7tf0S6BoOieFtFs/DvhzT7bS9L0+JYLWzs4lhhijX7qxxoNqr9K26KACv52P+C2v/I8fD7/sFP8A+j5q/onr+dj/AILa/wDI8fD7/sFP/wCj5qAPwqooooAKKKKAP3y/4Iff8hD4rf8AXHS//Qriv6Cq/n1/4Iff8hD4rf8AXHS//Qriv6CqAP4y/wBvr/k7b4kf9hy8/wDSiWvjevsv9vwMP2uPiXHg8a7df+PSs1fG2xvQ0ANop2xvQ0bG9DQA2inbG9DRsb0NADaKdsb0NTrbTuwCxsSwyOOtAFaivZfDH7Pvxz8b2kd/4M8A+JNdtpPuy6bp9zcr/wCQkevuz4T/APBJX9qDx9PFc+Mraw8Dac7ZeTUplmuNnotvBv5/3ttAH5X9a/Qn9kz/AIJ6fF/9pi7tddvLaTwt4HJV5NcvImU3EXpZR/8ALZv9r7v+1X7ffs+f8EtP2dfg19n1zxZbt8QvEUeG+061Eq2cbf8ATKwy6f8Af9pq/SyOKOCMRxgJGgwqjgAUAeOfA74BfDP9njwZF4J+GOlrYWhKyXU7nfcXUu3b5txJx5jkV7XRRQAV4P8AtTf8myfF3/sQ9f8A/TbcV7xXhP7UEby/sz/FqKMZd/AuvKoH946bcUAfw80U7Y3oaNjehoAbRTtjeho2N6GgBtFO2N6GjY3oaAG0U7Y3oaNjehoAbRTtjeho2N6GgBtFO2N6GpFhmf7iE/hQBDRXq3hH4I/GHx/CLjwL4J1/xBGW27tLsLi6/wDRSPX3X8Lv+CUX7Vnj64jm8RaXY+CNOk/efadZuFMpX+79mt/OnWT/AHttAH5hKjOQqDJav1c/Yq/4JoeOfjveWHj34tW9x4Z8A5WZYnVor3UU/u26t/q4X/57f981+u/7On/BMf8AZ/8AgW9vr3iC1/4TrxPAN/23VokNrE/96Gz+ZF/4Fur9JaAOa8JeEvDngXw3p/hDwhp8GlaNpUK21nZ2y7Yool+6qrXS0UUAFFFFAH//0/38ppCnqKdRQBH5cf8AdH5UeXH/AHR+VSUUAR+XH/dH5UeXH/dH5VJRQBH5cf8AdH5UeXH/AHR+VSUUAR+XH/dH5UeXH/dH5VJRQBH5cf8AdH5UeXH/AHR+VSUUAR+XH/dH5UeXH/dH5VJRQA0BR0FOoooAKKKKACiiigAooooAKKKKACiiigAqMorffAqSigCPy4/7o/Kjy4/7o/KpKKAI/Lj/ALo/Kjy4/wC6PyqSigCPy4/7o/Kjy4/7o/KpKKAI/Lj/ALo/Kjy4/wC6PyqSigCPy4/7o/Kjy4/7o/KpKKAI/Lj/ALo/Kjy4/wC6PyqSigBoCjoKdRRQB/Ez+2R/ydh8X/8AsdtY/wDS2avmmvpb9sj/AJOw+L//AGO2sf8ApbNXzTQAUUUUAFf19f8ABLj/AJMc+HX+9q3/AKdryv5Ba/r6/wCCXH/Jjnw6/wB7Vv8A07XlAH6BVH5cf90flUlFAEflx/3R+VHlx/3R+VSUUAR+XH/dH5UeXH/dH5VJRQBH5cf90flR5cf90flUlFABRRRQAUUUUAFFFFABX87H/BbX/kePh9/2Cn/9HzV/RPX87H/BbX/kePh9/wBgp/8A0fNQB+FVFFFABRRRQB++X/BD7/kIfFb/AK46X/6FcV/QVX8+v/BD7/kIfFb/AK46X/6FcV/QVQBGyRn74FHlx/3R+VSUUAR+XH/dH5UeXH/dH5VJRQBH5cf90flR5cf90flUlFAEflx/3R+VOVVHSnUUAFFFFABRRRQAUUUUAFFFFAEflx/3R+VHlx/3R+VSUUAR+XH/AHR+VHlx/wB0flUlFAEflx/3R+VHlx/3R+VSUUAR+XH/AHR+VHlx/wB0flUlFAEflx/3R+VHlx/3R+VSUUAR+XH/AHR+VOAUdBTqKACiiigAooooAKKKKACiiigD/9T9/KKKKACiiigAooooAKKKKACiiigAooooAKKKKACiiigAooooAKKKKACiiigAooooAKKKKACiiigAooooAKKKKACiiigAooooAKKKKACiiigAooooA/iZ/bI/5Ow+L/8A2O2sf+ls1fNNfS37ZH/J2Hxf/wCx21j/ANLZq+aaACiiigAr+vr/AIJcf8mOfDr/AHtW/wDTteV/ILX9fX/BLj/kxz4df72rf+na8oA/QKiiigAooooAKKKKACiiigAooooAKKKKACiiigAr+dj/AILa/wDI8fD7/sFP/wCj5q/onr+dj/gtr/yPHw+/7BT/APo+agD8KqKKKACiiigD98v+CH3/ACEPit/1x0v/ANCuK/oKr+fX/gh9/wAhD4rf9cdL/wDQriv6CqACiiigAooooAKKKKACiiigAooooAKKKKACiiigAooooAKKKKACiiigAooooAKKKKACiiigAooooAKKKKACiiigAooooAKKKKAP/9X9/KKKKACiiigAooooAKKKKACiiigAooooAKKKKACiiigAooooAKKKKACiiigAooooAKKKKACiiigAooooAKKKKACiiigAooooAKKKKACiiigAooooA/iZ/bI/5Ow+L/8A2O2sf+ls1fNNfS37ZH/J2Hxf/wCx21j/ANLZq+aaACiiigAr+vr/AIJcf8mOfDr/AHtW/wDTteV/ILX9fX/BLj/kxz4df72rf+na8oA/QKiiigAooooAKKKKACiiigAooooAKKKKACiiigAr+dj/AILa/wDI8fD7/sFP/wCj5q/onr+dj/gtr/yPHw+/7BT/APo+agD8KqKKKACiiigD98v+CH3/ACEPit/1x0v/ANCuK/oKr+fX/gh9/wAhD4rf9cdL/wDQriv6CqACiiigAooooAKKKKACiiigAooooAKKKKACiiigAooooAKKKKACiiigAooooAKKKKACiiigAooooAKKKKACiiigAooooAKKKKAP/9b9/KKKKACiiigAooooAKKKKACiiigAooooAKKKKACiiigAooooAKKKKACiiigAooooAKKKKACiiigAooooAKKKKACiiigAooooAKKKKACiv5Qf29/j38bfCv7VnjzQfDPjvxFpWnWl8qW9rZ6hcQxRqq/wxo9foP8A8Ecvid8Q/iPY/FdvH3iTVfEJ06TRFszqdzJctCJV1BpArSH5d+1fyoA/beiiigD+SH9rT9lT9o/VP2mfidrugfDHxZrOn6x4q1HULK+0/Sru5tpobq4aWNlmiQr/ABV83f8ADIn7Vf8A0Rzx3/4Ir/8A+MV/bfRQB/Eh/wAMiftV/wDRHPHf/giv/wD4xR/wyJ+1X/0Rzx3/AOCK/wD/AIxX9t9FAH8SH/DIn7Vf/RHPHf8A4Ir/AP8AjFf1Hf8ABOzwZ4s+Hv7IHgbwh420m80TWdPbU/tFhfxNBPF5up3Uq+ZG/wAy5Vw1fcNFABRRRQAUUUUAFFFFABRRRQAUUUUAFFFFABRRRQAV+FP/AAVz+C/xb+KPi3wNf/Djwbrviq3stNliuW0axuLzyn85mG/yAdvDV+61FAH8SH/DIn7Vf/RHPHf/AIIr/wD+MUf8MiftV/8ARHPHf/giv/8A4xX9t9FAH8SH/DIn7Vf/AERzx3/4Ir//AOMUf8MiftV/9Ec8d/8Agiv/AP4xX9t9FAH4f/8ABIP4O/Fb4VX3xJk+JXhDW/C41KHTvsn9s2U1m0uxrjdtWULuxur9wKKKACiiigAooooAKKK/lq/4KX/Gn4s+Fv2xPGfh3wv4t1fTNMsLfSvJtbS5kiijL6bbzt8qn+JmLUAf1K0V+A3/AAR8+JfxC8efEDxtb+MvEOpa1DBo/mRpfTtMFfz7ddy7v9lq/fmgAooooAKKKKACiiigAooooAKKKKACiiigAooooAKKKKACiiigAooooAKKKKACiiigAooooAKKKKAP/9f9/KKKKACiiigAooooAKKKKACiiigAooooAKKwPEHiPw/4S0e58QeKNStNI0uzTfc3t/NHbwQoP4pJJWRFX6mvzj8ff8Fa/wBkfwRqH9nabd694tYZDy6HZL5at6Fr6ez/AEoA/Tuivxrh/wCC0fwDeZlm8JeJEh/voIGb/vnen/oVfTHwf/4KU/sofGS6h0my8SzeF9Uuflis/EsS2bMf+uyvLa/+RaAPvyiiigAooooAKK+Wfjj+2L8Bf2c/EFh4Y+K+uS6ZqOpWv223ijtpZswb2j3FkU/xK1HwO/bF+Av7RniC/wDDHwo1yXU9R021+23EUltLDiDese4M6j+JloA+pqK+Rfj1+2/+zl+zncS6T8QfEvm66kXmjRNKia7vSP8AaVcRQn/rvJHXxNqH/BaX4BCbZo/hHxLNH/fvRb25/wC+YnuaAP2Tor8vPhx/wVs/ZV8cXw0zXZ9Z8Izfwzavaq1u5/2ZLWW5b/x2v0l8P+IdB8U6Ra+IvDGpWmraXfR+ba3tjKlxBMn96OSJmRl/3TQBvUUUUAFFFFABRXz58cP2ofgh+zrpq3nxU8UWumXMq7rbTYz517P/ANc7dPn2/wC021f9qvzx1X/gtL+z8j7dB8KeJblfW+W3tv8A0VLc0AfsjRX5ReCf+CwX7K/iXUU07xDH4h8LAjb9svrNZrUN/wBuss0//kKv0GufjR8NIvhbd/Ge11y21HwfaWb6g+o2B89HiTrt2feb+HbQB6vRX52R/wDBUz9jeVxGnim7y3/TlLX6FwzR3EK3EJ3RuoZW9RQBYooooA/FP9pX/glV4o+O/wAavEfxWsfG1hp8GvXPnpazwys0X/Al4r6h/YN/Yp1X9jy38apq3iODxBJ4tbT2X7PE0awrYfauPm/v/af0rr/iZ/wUH/Zi+EfjXUfh9431+6tNZ0mQRXUSWkjqjf71eo/AP9qP4OftLR61N8JNVl1IeHjbjUFmhaFo/tXm+T97+/5D/lQB9F0UUUAFFeO/Gv45/Dj9nvwaPHnxPv203R3vI7FJUjaRmmlVmRVVf9lGP4V86eB/+Cjf7KvxE8YaP4E8L+I7qfVtdvYdPsY3tJUV5522xru/2moA+7aK8Y+MX7QHwg+AGiR6/wDFrxLa6DbXBK28cgklnmYdVht4leWT/gK1+cGt/wDBZ39ne0maLw/4Z8T6gVO3zLlLW2jP/AlnmP8A47QB+w1FfkB4V/4LJ/s9aveRWnifQNf0RZuPtMSw3UMf/XT54XX8Eav0o+Ffxs+FPxv0AeJvhV4lsPEViu3zPsr4lhZvurPA+2WFv9mRFNAHq9FFFABRRRQAUVg+IPEWgeFdIuvEXijUrTSNKsYzLdXt/KlvBCn96SSRkRVH+1X5u/ET/grZ+yf4Hv207R59b8XyJw0ujWiiEN6eZeS23/oNAH6gUV+KUH/Baz4RPrMlvP4E1uPS1A2XQuIGkJ/647f/AGevpP4T/wDBUj9k74qajHo02t3ngy9mk8qFPE8C20Ujf9fUUs1vH/21daAP0aoqjb3Ftf20d1ayLPBMokjkQ5V1b5lZWXtV6gAooooAKKK4rxx4+8GfDXw7ceL/AB7rVloOj2pVZby+mWKPc2dqKW+87fwquWagDtaK/KDxr/wWE/ZX8N6g+n+HIvEPilVH/H7Y2awWpb/t6lhn/wDIVeY6T/wWs+Ek95cR634C1qztIn2xTWt1BcPIv97y2WHb/wB9UAftbRXwN8GP+Ckf7K3xrurfSNN8STeGtYufkjsPEkS2bs3+zMjzWv8A5Fr75oAKKKKACiivj743ftxfAD9nnxgngX4mapeWmqvbJdeXBbtMAkv3fm3CgD7Bor5j+A/7WnwW/aOtPEV98MtVlmg8KLbvqr3kXkCFLoStE25m27dsEmT2xXxR8Y/+Cv8A8B/h9qc+jfD3SL/x9Pav5b3VvKtnZMR/zznZJmk/74oA/XOivyd+GX/BXz9m3xpqNtpHi611jwbPcLj7TdxLdWaP/daSD97/AOQq/UjR9Z0nxBpVnruh3kGoafqMKXNpdWzrJFNFKu6OSN0O1lZfutQBtV+Pv7WP/BMLVf2kvjfrnxfsvG1vo0etw2cZsZrZpGQ2tpHbbtwPfy91fsFXxX8Yv2+P2cvgR47vfhv8QNXvINc05IpLmG3tmkVVnjWWP5t3dWFAHlf7Dv7BmqfsieJfEHiC/wDFUHiD+27BbIRw27Q+XiVZN3P+7X6UV8sfAH9sL4J/tJ6pqOi/C3ULu7udLt1urhbm3aHEbNt3c/7VfU9ABRRXmnxa+K3g34J/D7Vfif8AEC5ez0DRRE13NFGZXHnzx20W1F5YtLKi/jQB6XRX55+Hf+Cnf7J/inXdP8OaTrWote6lcpawK9myrvl+7u+bivrP4sfG74VfA3w4fFXxW8SWfh3TxkRm4ZmlmZf4YYIleaZ/9mNGoA9Zor8cPF3/AAWg+Aulwzf8Id4U8Q65NF91bzyLKOT/AHZFe5/9BrnPB3/BbH4SaiSPHnw/13Q/+wZcwal/6MWyoA/bKivBvgp+0r8F/wBoTTDqPwq8S2urSRIslzZZ8u7tw3/Pa3b50r3mgAooooAKKK4nx14/8FfDXw7P4s8fa5ZeH9Htf9beX0qwx7v4UXf952/hVfmb+EGgDtqK/Ijxz/wWN/Zz8O3l1p3hHSte8UPbjal2sUdpaSt/0zaVnn/76irgfCP/AAWz+FF+WHjj4ea5omOn9m3dvqOf++1s6AP21or5g+Av7XnwE/aOQwfDLxNDc6qkXmzaReD7Nfxj+LMLn5tn8TRll968f+IH/BSn9mD4aeNdc+H/AIl1PU11fw9ey6ffLDaqUWeBtsiqzSpuw1AH3/RXhnwE/aC+HP7SHg258d/C+5nu9Ls9Rk0uZrmLyXW4iihmZdp/2J0/Ovc6ACiiigAooooAKKKKACiiigAooooA/9D9/KKKKACiiigAooooAKKKKACiiigArgviV8QvC/wo8C638RPGl2LLRdBtHvLqX+Iqn3UjXPzSO2ERf4mIWu9r+eX/AILL/H69udf0D9nfQ7jFpZQrreshD9+aXcttE3+5Hub/AIFQB+fX7XH7anxJ/au8UO+q3Uuk+EbSU/2XoMDlYox/z1n7TT+p/wC+cV5Z8D/2Xfjh+0TdTQfCbwxc6xDZsFubt2jgtYt38LXE7pFu/wBmtb9kj9nrUv2l/jbo3wztpmtbCQm81W8UZMNnB80jL/tv91PrX9k/gXwJ4S+G3hbTvBXgbS4NH0XS4VgtbW3XaqqP4m7szH5nZvmZuWoA/mU1X/gj/wDtX2GkHULAaDqV2Pu2MN6qS/8AfyXZF/4/X59/FP4O/Ez4IeJ38LfEzQbzw7qifMiXK7VkX/npDIvySR/7SV/dJXzT+1F+zd4L/aa+Fuo+A/E9vbpqC28sui6nIu57K92/u5VYfN5e7Hmr/EtAH4Xf8E7f+Cg2u/C7XNH+CXxb1A3ngm/lSy029uW+fSndvlG4k/6J83/APpX9M9fwUeI/D+teDvEmpeGNfgksdU0a8lsbyF+Hint5DHIrf7Sstf1hf8Eyvjxd/Gz9mrT7LXZ/P1vwVMug3Ln70kEUa/ZJW/34vl/4DQB+itFFFAH8yv8AwWu/5OP8G/8AYkQf+nDUK/Pv4AftE+Mf2c7zxXrfw9YW+ueJNAk0GG//AIrNJZ4J5J4f+mn7jalfoL/wWt/5OP8ABv8A2JMH/px1Cvy++EHwy174yfEnw78MvDQAv/EOoQWKOVZliWVtrTSY/wCWcX3noA2fhv8ACD4y/tDeLJtL+H2hap4t1aZzPeTRKz7PNb/W3V1J8kau38Ur19Wyf8ErP22YrM3f/CD25lDf6hdW0wyfn9q2/rX9Q3wR+DHgv4B/DfSPht4HtI4bLTIESWcRqkt1PtVZLmbb96WZl3Oa9eoA/g58c+AfGPwz8RXHhTx7o97oer2p/eWd9C0Mqr/C21x91q/Qz/gm7+1/rfwN+LemfDzxHqDt4B8WXa2dzBIV2WdzL8sd6rfw/N/rv9mv1l/4K0fBTw746/Zsvvii1qB4h8BzW89tdov71rS6uFtp7f8A657pkk/4BX8s1nJHBeQzSpvjicMw9RuoA/vuorzr4SeKpfHPwp8F+NrjPm6/4e07VXz13XdpHO3/AKHXotABX50/8FBP20Yf2WfAVvpHhVY7nx14lWRNNjcgpZwpw13Iv/opf4m/3a/Rav4u/wBtH43XHx+/aP8AF3jgXX2nSY7t9O0XbwosLVilv/33/rG+tAHzr4u8ZeJ/iD4ivvFXjDUbnVtY1KZ7i5urp2keR2r7a+DX/BNT9qb4w6XB4htvDsfhzSrkb4LrXJVtmkH95bf/AI+Nv/AK+ov+CTv7I+ifE7XtQ+PPj+yjv9F8M3a2Wj2lwm6KXUkWOdpmX/p23Lj/AGjX9KVAH8f/AMZf+Ccf7UvwZ0q58Q6r4YXW9Es13z3+jTJdbF/iZoU/0hY1/wByvBPhX+0B8QPhJ4f8UeB9IvHfw34xtGstW0uX5om4+WZV/hmi7V/b3X8yf/BVr9kvS/hH41034z/D7TEsvDPip2ttQtrcbYrbUvvbtv8ACtyuT/vBqAPx8sf+P23/AOuyf+hV/e1oX/IF0/8A69Yv/QFr+CWx/wCP23/67J/6FX97Og/8gTTv+vSL/wBAWgDWooooA/jm/wCCjX/J4nxD/wCv/wD9lr9Jf+CGv/Hj8Zv+uvh//wBB1Svza/4KNf8AJ4nxD/6//wD2Wv0l/wCCGn/Hn8Zv+uvh/wDlqlAH76UUUUAfkr/wWb/5NP0f/sdrD/0i1Cv5t/hN48m+FvxO8K/Em2tkvZvC2sWurRW0jbVkezlWdUYj+FmWv6SP+Czf/Jp+j/8AY7WH/pFqFfy4qjOQqDJagD3Hxr44+Mf7UnxUm8QayuoeK/Fev3Hlw2djFJM3/TOC3t4vuon8CrX1j4Z/4JV/tja7Zm+vPCtto48nzYUvNQst8jf3WVJ98f8AwKv26/4Jwfss6N8BfghpHizUbeKTxh4zsoNUvrox7ZYba6SOeGz/AOALjf8A7X+7X6OUAfxAfGf9mr42/s+30Vj8W/Cl3oguDtguW2zWsrf3Y7iBnikb/gVVPgN8ePHn7O/xB074heArySGe1dftNqzfuruH/lpBMo+9G9f2W/G74Q+F/jt8MNd+GPi6COWz1m1kijkkRXa3uNreTcxhv44X+Za/hz1Gzm03UbixuInikt5WiaKTqCrfdagD+6D4T/EfRPi98N/DfxN8O8af4j06G/iQsrmJpV/eQsy8b4X3Rt/tCvSa/MD/AIJGeLf+Em/ZCtNNwQPDWv3+kDP+7Def+3Vfp/QAVxPxB8c+G/hl4L1rx/4wuhZ6PoVm95eTYy2xB0Vf4pH+6i/xMQtdtX4Af8FmvjrqC3nhr9njSJTHaSW6+IdW29XbdJFaxf7vys340AfnJ+11+2x8SP2rfE8y6hPNo/g60k/4lnh+N/3SD/nrcf8APaf37fw4ryn4F/st/G/9o27ng+E/hufVYbRgl1eO0cFrFu/haaVkTd/s079lr4EX/wC0f8bfDvwps5pLOHUpS99doufJtYEaWZ+eN21fkr+yz4b/AA18GfCXwXpfw/8AAGmw6To2kRLDDFCqqXKgK0szKv7yZ8bnkb5nb5moA/m1vv8Agjf+1Jb6a99BqHhe6nzkWcd3MJf++mgSL/x6vz7+MXwH+K3wC8Rjwv8AFbw9c6FfMpeATbJYZ1B+9DPEXim/Ov7kK8H/AGhvgF4I/aP+GuofDrxrbxkXMbGxvxGrz2NxjCXELN91l/8AHqAP53f2AP8AgoJ4p+BviPSfhb8TtRN98Ob2VbZXuWzJpJb7ssbf88P78df1JRyxzxiSMh43GVYcgiv4QPHng/Wvh3401zwNr8Yh1PQNRuNMvERs7ZrWRopF3fVa/qH/AOCU/wAdrz4s/s7f8Ilr919q1nwFcrpRLDDmwZN1kzf3vlV13f7NAH6gUUUUAeLfH742+Ff2evhZrXxT8XsXs9Ki/c2yMBJc3D/LDBHu43u1fyD/ALSX7UfxT/ae8Yy+JfHuoSLYxyMdN0eJ2+x2UX92OP8AvcfO5+avvT/gsD8d9R8YfGi2+CWnXDx6J4Ktop7qAD5ZNQuo/N3/APAIJFX/AL6r5P8A2D/2ZIv2ovjla+FtZWVfDOjQHVNbkjO0tbxsqrCrfwtM7UAcn8Av2Mv2gP2kP9O+HXhmRtFDhZNYvWW2s1/vbZJSnmsv92PNfWuvf8Edf2q9J0o3+nXPhjWrlRlbKzvpBL/u7rqC2i/8fr+nfQfD+ieFdFs/D3hnT7bS9LsIlgtbKyiWGCJF+6scabVVfpW7QB/Ch8TPhb8Qfg34sufBfxF0W70HWLTbI0FyNu5W+7JG33ZFP8LLX67/APBOP/goV4o0bxVo3wG+NOqC/wDDt9ix0XVrtsS2Mv3YbeST+KB8bRu+7xX68fto/sxeH/2nvg7qvhmS1i/4SfT7aW68OXx4eC7xu8vd/wA87jb5b/Wv41Z7e60u9kt50MU9rJtKuMMGVv7rUAf31UV8Sf8ABP7493f7Qf7M/h3xTrc5uNf0Z38P6zM/3pbqzVdsx/vNNA8Uj/7TNX23QAV/LN/wWI/5Ooj/AOxftK/qZr+Wj/gsR/ydRD/2ALSgD4J8D/Gzxb8P/hR47+F/h2UW1n8QZtNXVZkbEpt9O+1N5H/XOVrn5/pXOeB/hD8VPiWl1J8OvB2v+KUtf9edGsLi9Mf+8sCPXY/s1fB27+Pvxz8H/Ci2laBNev1ju5k/1kdpErT3br/eZLZHav7S/A3gTwn8N/C+n+C/BGmxaRo2mQrBb2tuu1Qq4+Y/3mb+Jm+ZqAP4o/DPwM+I+sfFXQfhBq2iX+h69rmo2mnrbanbTW7xNdSLErTK6o6r81f2x+BvCGj/AA/8F6D4E0BDHpnh7TbfS7NT1EVrEsUf/jq1o3miaRqd5Y6lqFjbXV3pztLaTzRK8kDMu1miZvmjZl4+WtygAr+RX/gqp/yfB47/AOvbSP8A01Wtf11V/It/wVU/5Pg8d/8AXtpH/prtaAPrX/gid/yUfx1/2BG/9KLWv6NK/nJ/4Imf8lK8c/8AYCb/ANKbWv6NqACvgX/gp/8A8mM/E3/c0j/09WFffVfAv/BT/wD5MZ+Jv+5pH/p6sKAP5Ofhx4lg8GeO9D8WXMRuItIvEuzEOC/lfNtr1b4vfF/4t/tdfFY61ra3ms6zqk3kaVpFgkkywIf9Xb2sK81821/Ud/wSr/ZZ0f4YfCGy+NfiSwiPi7xpD9ptZpB89rpsv+pSP+79oXDv/wABoA/KTwV/wSj/AGu/Fdh/aGo6HZeHVkVWiTUryDzT/vRxO7R184fHH9j39oP9naEX/wATvClxY6ZI+yPU4GjurQt/CrTQM6Kz/wB1q/tYrlfGfhDw34/8L6n4L8X2MWpaNrFu9reWswyskTrhhQB/Dp8NfiX4z+EPjLTPHvgPUpdK1nTJhLDNCeq/xRv/AHkf7rq1f2afsy/G7Tf2h/gl4Y+KumqkMuq2qrf2yci3vIvkuIv++vu/7JFfxnfFzwQ3w0+KPi74emYznw1rd7pJkxje1rO0Df8AoNf0Q/8ABFrVfM/Z/wDFmgn/AJdvEzah/wCBVvHF/wC2tAH7I0UUUAeafFn4o+FPgx8Ote+J3ja5Fto+gWrXE5/idvuxwx/3pJpGWNB/eav49f2nv2qvij+1L41fxD45vPJ02CR10vR4GxbWcTN91f7zfL80jV+r/wDwWk+MdzGPB/wG0qUpHLG3iXVUT+P5mtrRW/4F5rV+QP7MPwQ1T9of40+G/hZpxeGHVLndfXKD/UWkC+ZcS/8AfK8e9AG58Av2Qfjv+0ncPJ8M/Dk02lwOFn1a6KwWcZ/u+bLsWR/9lM19heIf+CO37VeiaOdS0258M69dKNy2FheyLL/u7ryC2i/8fr+mTwT4I8LfDfwtp3gzwXp0Ok6LpUKwWtpbKFRVX2x8zMTuZvvM3JNdlQB/C1e6d8Vv2eviNA99BqXg3xfoM6zwl1aC4hdfustYfxD8b6x8SfG2t+P/ABCUfU/EN/Pqd8Y1CIbi4bzJmVV4VWZq/rA/4KC/so6P+0d8G9U1LSNOSTx34ZtXvNDuo03TSiL95JZf7SzY/wC+ttfyEurRsVPUGgD+n7/gi3/yat4i/wCx8v8A/wBN2l1+vNfkN/wRb/5NW8Rf9j5f/wDpu0uv15oAKKKKACiiigAooooAKKKKACiiigD/0f38ooooAKKKKACiiigAooooAKKKKACv42P+ChHiuLxj+2L8T9UjyTa6w2lP9dNjWx/9Bgr+yev4ov2z9Nu9M/av+LS3cZjNx4x1e5i/2klvZmVqAO//AGLP2trP9kLxjrfjhPCJ8U3+raW2lDN59kWOFpoZ/wDnhN/zwr9Gv+H4tx/0SJP/AAdN/wDINfnl+xn+xPrv7YR8WLoviCy0P/hFPsXnC6EhMv2z7Rt27Ef/AJ4V9y/8OS/Hv/Q/aP8A98T/APxigDqP+H4tx/0SJP8AwdN/8g0f8Pxbj/okSf8Ag6b/AOQa5n/hyX48/wCh+0j/AL5n/wDjFWv+HJfjL/ooel/9+Z//AIigD8jPj58T7D4zfFzxJ8TtP0UaCniO/l1GWxEvnhJp23St5mxN29vav2J/4If6iYdQ+Kuk9ryHS7j/AMBWuF/9uKyf+HJfjL/ooel/9+Z//iK+5f2Gf2A9Z/ZG8beIPF+r+KbfXjrOlLpiRW6Omz9+szP8/wDu0Afp3RRRQB/Mt/wWt/5OP8G/9iTB/wCnHUK+fP8AglfGj/tw+Aiw+5Bq7D/wU3lfQf8AwWt/5OP8G/8AYkwf+nHUK8h/4JM3tpB+2L4ctp/9fdWWpLCf92wuGagD+seiiigD5a/bXAP7KnxJB/6A7f8Ao2Ov4qK/tZ/bV/5NX+JX/YEf/wBGR1/FNQB/cR+y/wD8mz/CX/sRdB/9NtvXuleFfsu/8mz/AAj/AOxF0D/0229e60AeQfH3xJfeDPgT8R/GGlP5d9ofhLV9Stn9Jbaxmljb/vpRX8Nk0jTStKwALsTgcCv7ff2nbObUP2bPivZW4LzT+CNcjjAHJf8As+42/wDj1fw+MjISrjBWgD+xL/gm/wCGV8K/safD2zeIR3F1De3lzju8t/cNu/75219zV8bf8E/vEUfij9j34a6woxv0+4gx/wBet7cQf+06+yaACvgP/gpzoVvrX7FPxBd4POm09bC9t+PuumoW6M3/AH7d6+/K+Kv+CiWvN4a/Yy+JmsIoZks7OAA/9PGo2sH/ALUoA/jm0/8A4/rX/rsn/oVf3saD/wAgTTv+vSL/ANAWv4J9P/4/rX/rsn/oVf3saD/yBNO/69Iv/QFoA1qKKKAP45v+CjX/ACeJ8Q/+v/8A9lr9Jf8Aghr/AMevxo/66eHv/QdUr82f+Cjf/J4vxD/6/wD/ANlr9Jv+CGv/AB6/Gj/rp4e/9B1SgD99KKKKAPy7/wCCulnBefslkzqH8jxFazJ7MlteV/Kxp0Ym1C2RujTov/fTV/Vn/wAFbP8Ak0m4/wCw9a/+k91X8qGjf8hWy/6+Yv8A0KgD++JEWIBUACgYAFS0UUAFfw0ftAosXxu8cRxDCjW7pR/38r+5ev4af2hv+S3+Of8AsPXn/ow0Af0Qf8EXf+TVfEH/AGPl/wD+m7Ta/XavyI/4It/8mr+I/wDsfL//ANN2l1+u9ABX8gP/AAUz1WbVv2z/AIgzk5WKWztQB2FtZQwf+y1/X9X8cf8AwUUs3sf2w/iLCf4tSM4/7ar5v/s1AGN+xj+1N/wyT8R9X+IcHh9fEM+o6JJo6QvL5IjEs9vOz/8AkCv0p/4fdax/0TG1/wDBg3/xFfn9+xh+xXeftfXXiWzsPEkHh+Xw/Fby4mjaTzFl4/hr70/4cieJP+ilWP8A4CSUAXf+H3Wsf9Extf8AwYN/8RR/w+61j/omNr/4MG/+IqD/AIci65/0Uq0/8A3o/wCHIuuf9FKtP/AN6APyO/aO+L0Hx4+MfiL4sW2jpoQ8QzR3D2Mb71WVYY0kbd/FvZd341+pP/BErxX9l+KPxC8EKDjUfD8Gqsf+vK7WFf8A0srqP+HIuuf9FKtP/AN6+yv2IP8AgnhqX7IvxL1n4hX/AIvt/EH9qaHLowtobZodnm3NvP5m5mP/ADw2/jQB+pNFFFAH8Rn7V+qz63+0x8UtVkcut14u1Z4/aJr2Zo1/75r3f9ib9tub9jpPF5tPC0XiKXxW1llpLhofJWz+0fL90/8APevm39oyzk0749fEPT3+9Z+Ir+2b/einaNq+s/2NP2Abv9rnwhrfijT/ABhbaE+jXyWb2zwtK2JY9+6gD7J/4fda5/0TO0/8DW/+JpP+H3Wuf9E1tP8AwMej/hyLrn/RSrT/AMA3o/4ci65/0Uq0/wDAN6AD/h91rn/RNbT/AMDHr8Wfif4yT4h/EXxP46gsxp8XiHV7vVUs05W3W6maVYV5+7Fv2rX7Tf8ADkXXP+ilWn/gG9H/AA5F1z/opVp/4BvQB6T/AMER/E91f+Avib4SlAFvpGpabeR/717HdK3/AKTCv3Kr8+P2E/2Jb39jmPxpHe+JovER8XHT2/cwNCIfsH2r3/j+0/pX6D0AFfy0f8Fif+TqIP8AsAWlf1L1/LR/wWJ/5Oog/wCwBaUAP/4I4aBp+tftW32oXcYe40Hwne6jaP8A3Xae1sm/8hXTV/UpX8xX/BFT/k53xb/2Id3/AOnPTa/p1oAKKKKACv5Fv+Cqn/J8Hjv/AK9tI/8ATXa1/XTX8i3/AAVU/wCT4PHf/XtpH/prtaAPrP8A4Imf8lK8c/8AYCb/ANKbWv6Nq/nJ/wCCJ3/JSvHP/YDP/pRa1/RtQAV8C/8ABT//AJMZ+Jv+5pH/AKerCvvqvgX/AIKf/wDJjPxN/wBzSP8A09WFAH8iOl26XWpWtrL/AKuaZIz9Gav7n/g/pFpoHwk8EaBZcW+m+HNNtIf9yG0jjX/x1a/hj0L/AJDFj/19Rf8AoVf3afD3/kQPDX/YIsv/AERHQB2NFFFAH8S37Y3/ACdf8YP+x31n/wBLZq/bT/gij/yS7x7/ANhGy/8AbqvxM/bH/wCTr/jB/wBjtrP/AKWzV+2P/BFH/kmHj7/sI2H/ALdUAftvRRRQB/Ir/wAFR9cu9Y/bR8b288hMGnJp1rbL/Cu2wt93/j26vrT/AIIl+GLO5+JXxB8ZNzdWGhxaYv8AuXVzHK3/AKTLXxv/AMFN7FtP/bX+ItsOhewn/wC/+nW8/wD7NX27/wAESddsYfGPxH8OPKPtl3plrepH/wBMrebYzf8AfU9AH9ENFFFABX8O37Snh/TvCP7QfxM8KaLELfT9G8Xavp9tCOixW97NHH/47X9xNfxGftZ3ceoftRfFu7gbfFN421tkPqn2+bbQB+/X/BFv/k1bxF/2Pl//AOm7S6/XmvyG/wCCLf8Ayat4i/7Hy/8A/TdpdfrzQAUUUUAFFFFABRRRQAUUUUAFFFFAH//S/fyiiigAooooAKKKKACiiigAooooAK/k9/4KxfDu/wDBn7W2reICB/Z/i7T7PV7VVOcfu/s03/fc8Dt+Nf1hV8C/8FB/2U0/ab+DUi+H4Q3jPwp5uoaGduWm+X99af7txtX/AIEq0Afh1/wSy+PWmfBf9of+wvFF2LTQvG1n/ZDySnEUd1vjktZG7Lu2su7/AGq/q/r+Bi8sr3R7+axv4ntrqzkaKaGZcPHIjbWVlb+Ja/cr9lT/AIK6S+FtEt/BX7Sdne6uloqw2viDTUV7gr93F5G8iBm/2loA/odrPu7u1062lvb2VIIYUaWSWRtqIi/MzMzfdWvgtv8AgqJ+xEtp9p/4WA5k/wCfcaXqfmf+kuz/AMer8oP20/8AgqRd/Grw1f8Aws+C+n3mh+Gr/dBqWqXhjS8vYP4oljXesMb7v7zNQB33jr/gsp8StD+J+t6d4M8N+G9X8FWepT2+m3FxFepeT2kTbVmZvtWzc+N33K/S79h79sbXf2vtH8S61qPgr/hGLTQZLeCG7S6+0RXMsqyNIiq0SMrQ7R/e+9X8k3g/wf4i8f8AibTvB/hGwm1TWtVnS3s7OBd7yyPX9lH7Hv7O9j+zD8DdG+GgaKbVtz3+s3UQ+We+nxvYf7KIqRr7JQB9UUUUUAfzLf8ABa3/AJOP8G/9iTB/6cdQrwD/AIJU/wDJ8PgX/r11f/013Ve//wDBa3/k4/wb/wBiTB/6cdQr5/8A+CVX/J8PgX/r11f/ANNd1QB/XTRRRQB8uftq/wDJq/xK/wCwI/8A6Mjr+Kav7Wf21f8Ak1f4lf8AYEf/ANGR1/FNQB/cL+y3/wAmzfCP/sRdB/8ATbb17vXhH7Lf/Js3wj/7EXQf/Tbb17vQBQvbG21KzuNPvYxLb3UbRSo3Qo67WWv4cPjh8L/EHwZ+LHin4Z+Jyz3+ganPbtMV2+em7dFOv+zNHtkX61/c9X4w/wDBVT9jbVPifpFv8f8A4a6e134h0G2+z65ZwLmW5sYlZlnX+9Jbf+gf7tAHN/8ABHT9ofT9X8Fat+zzr11t1XR5n1bREkP+ts5v9ekf/XGTn/gdfuFX8F/hHxh4n+H3iSw8W+D9QuNI1vS5lntby2Zklida/cv4Rf8ABaW6ttPtdL+NPgk3t2g2TatotwsYkb+81m8fy/8AAXoA/oFr8L/+Cxf7RNjpfhXS/wBnHQ592p6lLFrGs7OAlqnmCCJv99vm/AVw3xd/4LSX17p11pfwU8Ff2fdyfJDq2s3Cy+W395bNIvm/4E9fiL4k17xp8Sdf1jxp4lubvXNVuS99qV9MWkf5m2tJI38K7moA5TT/APj+tf8Arsn/AKFX97Gg/wDIE07/AK9Iv/QFr+CrTf8AkJWv/XdP/Qq/vV0H/kCad/16Rf8AoC0Aa1FFFAH8cv8AwUb/AOTxfiH/ANf/AP7LX6S/8ENP+PT4z/8AXTw9/wCg6pX5uf8ABRv/AJPG+IX/AF//APstfpH/AMENP+PT4z/9dPD3/oOqUAfvrRRRQB+Y/wDwVs/5NJuP+w9a/wDpPdV/Kho3/IVsv+vmL/0Kv6r/APgrZ/yaTcf9h61/9J7qv5UNG/5Ctl/18xf+hUAf3z0UUUAFfw1ftD/8lv8AHP8A2Hrz/wBGV/crX8NX7Q//ACW/xz/2Hrz/ANGUAf0Pf8EW/wDk1fxH/wBj5f8A/pu0uv13r8hv+CLf/Jq3iL/sfL//ANN2l1+vNABX8sn/AAV4+GF74R/akn+IAWRrPxxpVndpJ/As1nAtjJH/AN+4Fb8a/qbr4s/bo/Zftv2o/gpd+HNNSJPFWjFtQ0C5k4/fquGgZv4Y7hflf8KAP55v+Cafx80r4FftKaa/iWZLfQfFts2gX9zIcJAZ2jeCRuwUTxorN/dJr+uyv4Jte0DXPCOuXmg6/Z3Gm6ppdw8Fzb3CNHLFLE21lZW5Vkav2L/ZF/4Kx6l8L/D1n8Pfj1p194j0jT0WCy1ex2vfxRL91JY5WRZ9n97erUAf0nVG7qiFnOAOpr87Yv8AgqZ+xhLYjUP+Ewuo5SP+PN9Pu/N/9A8r/wAfr8uv2y/+CqF58YPDWo/DH4Iade+H9Avw0GoatfFVu7uD7rRRwrvWGNwfn+bdQB2Hxb/4LGfFPQPij4h0v4U6L4W1XwjY3strpdzqEN3JLcRRNtWfdFcw/wCt7cV+jP7CH7afiX9ry18Sza14Si0CLw2lojXcErPFPPceZ8iq/K8R7q/k+8K+FfEXjrxFp/hTwpYz6rrOq3CW1naW6s8sssjbVVa/sd/Yt/Z0tv2Y/gNo3w+mEb63dMdU12aLlXv51USKrY+7EqJGv+5QB9bUUUUAfx6f8FIPhfcfDH9rvx3H9nljs/Et43iS1lfpKNR/fzsv+yly0q/hX0Z/wSG+Pui/C74yax8MfEsq29n8RYbW3s5yP+YlayMttD/wNbmRf97bX6o/8FKP2RZP2jfhUPF3g60abxz4MjlnsI4/v3tr96a0/wB75d0X+1/vV/KOG1PQdTDIZLK/spP9x43WgD++aiv59v2Yv+CwUGiaBa+FP2k9N1DU7m2VYo/EOmLFJLL/ALV1C7w/N/tJX3hff8FUf2NLTTmvofFl3eSKufscGn3Pnf8AfTqkX/j9AH334l8QaP4S8Pap4q8RXKWOlaNZzahe3Mh+SKC3RpZZG9kVS1fzi6p/wWh+O9v4mv20Xwr4Vn0Jrl2s47uG7NwsP8KtJFebN3/AK8z/AG2v+CkPib9pTTZPh18PbC58M+CvMP2pZpAbrUF/5ZrPt+RU/i8n5v8Aeavz3+FHwr8b/Gvx1pnw7+H+nPqWsarIERBwsa/xSyN/BGg+Z2oA/rY/Yk/ah8QftYfDfUviDrHhqPw7Baao2mW/lStIs5ijR5GXd93aXFfaleK/s+/BrRv2fvg94a+EuhSG4g0K12SXJGGnuJXaWeVh/tyuzV7VQAV/LR/wWJ/5Oog/7AFpX9S9fy0f8Fif+Tprf/sX7SgDof8Agip/yc74r/7EO7/9Oem1/TtX8xP/AARU/wCTnfFv/Yh3f/pz02v6dqACiiigAr+Rb/gqp/yfB47/AOvbSP8A012tf101/It/wVU/5Pg8d/8AXtpH/prtaAPrP/gid/yUrxz/ANgM/wDpRa1/RtX85H/BEz/kpfjn/sBN/wClNrX9G9ABXwL/AMFP/wDkxn4m/wC5pH/p6sK++q+Bv+Cnn/JjPxN/3NJ/9PNjQB/InoX/ACGLH/r6i/8AQq/u0+Hn/IgeGf8AsD2X/oiOv4S9C/5DFj/19Rf+hV/dp8PP+Sf+Gf8AsD2X/ohKAOxooooA/iX/AGx/+Tr/AIwf9jtrP/pbNX7X/wDBFD/kmfj/AP7CFh/7dV+KH7Y//J1/xg/7HbWf/S2av2w/4Iof8k0+IH/X9Yf+3lAH7cUUUUAfzf8A/BZz4Q3ui/Ezwv8AGezhJ03xDYf2TeSD+G8tdzL/AN923/oFfDv7B37QMP7OH7Q/h7xjqspj8P6qraNrjfN8tndMvzf9sZVjm/Cv6oP2mfgXof7Rnwa8Q/CzW9kUmoQGXT7phn7NexfNbTf8Bb73+yTX8bHxc+Enjn4H+O9R+HvxD099N1fTZMMh+5InO2WFv4o3/gagD+5i1urfULaO8spEmhmRZY5I2DIyN8ysrL95WrRr+T/9lP8A4Ka/Ff8AZx0C18Ca9YReNvClp8lnZ3U7QXVqn/POG52uqx/7LI22vt/V/wDgt1oUenW50T4WTy3s0WZVn1dUSB/7ufsP7z/x2gD9VP2p/j7of7NnwW174mas8bXkEL22j2rn/j51CVW+zxf7u4bn/wBkNX8UWoX93ql9caheyPNPcSNJJLIdzFm/vNX0l+0P+1F8Yf2rvF0OoeN7nzIInaPS9EsQy2ttv7Rx/wATf7TfNXzhqOm32i6jcaZqcMlvd2sjRyRSrhlZf7ytQB/Th/wRa/5NX8Sf9j5e/wDps0uv13r8iP8Agi3/AMmr+I/+x8v/AP03aXX670AFFFFABRRRQAUUUUAFFFFABRRRQB//0/38ooooAKKKKACiiigAooooAKKKKACiiigD8+f2sv8Agnp8Jf2nDL4mtz/wifjXb/yGbKJClz/s3sPHn9B827dX4b+PP+CUv7Xvg7VZLfSPD1n4psFPyX+k3kG0/wDbGd4bj/xyv6zqKAP4tf8Ahh79rQat/Y3/AAqrxTv37fP/ALOufs/+952zbX0b8OP+CT37WXjbUFi8RaPp3g6wJLNd6pdxv+Cw2/nT/wDfW2v6vaKAPh/9lL9hT4R/ssWf9p6Kja74vniaO68QXiASbX+9HbRr8sEX+yuW/wBqvuCiigAooooA/Gv/AIKN/sKfGP8Aah+K/hzxx8NW077Jpnh5NKuVu51hk81Lu4n+Xd/Dtnry79h7/gnR8e/gF+0b4c+Knj06Uuj6Nb3yyfZ7hZZS11ZyWyhVX031+8tFABRRRQB4h+0b4B1z4o/A7xl8P/DXkjVNc0x7W0+0Nsi8zcrLub+HpX85/wDw6A/aq/556N/4GQ1/U/RQB5d8FvCOqfD/AODfgTwJrRifUfDfhnS9IvDBzEZrO0hgl8v/AGd6HbXqNFFABRRX8m/xz/bB/as+D37SPxO0Dw18RfEFtZ6f4q1W0srS8na6torWK9kWHyYbrfEq7PagD9cv2lv+CVXwd+Nur3PjHwDet4B8Q3chmuhawLNYXDn/AKdtyeS3qyf981+bOq/8EZf2mLGU/YNd8J6jF1Xybm5Df98y20K/rX6X/wDBM39sHxV+0p4Q8ReHfitrUOpeN9BvPPVlt4rV5bCVV2t5cCJF+6l3Kfl7rX6m0Afzc+A/+CKfxavr4N8SPGvh/SLDv/ZS3N/cf98ypZx/+P19I/tp/s9/Br9k39hXXvCfgKxEN14h1Ow0+41S7VZL69lR2uVEsiqn/PA8Lha/bWv58f8AgsR+0d4c19NF/Z48L3Ud5caVf/2rrzRc+TcRxyRW9u3+1+8Zn/4DQB+D1msj3kKx/wCsaRcfXdX98trbpa20Vsn3YkVB/wABr+ML9iL4aTfFr9qX4d+ExEstousRahfI4+VrOw/0m4Vv9+OLb/wKv7R6ACiiigD+fX9rr/gmp+0L8av2g/FnxL8G/wBlf2RrNwJ7Yz3So/8AwJTX17/wTT/ZB+KP7KNv8Q0+JjWJk8VPpf2QWcwm+WyF5v3en/HyK/U2igAooooA+L/27fgV4z/aL+BE/wAN/ARtRqz6lb3mLuTy49iJMjfN/wBtK/EbS/8Agj/+1DBqFtNc3GgxxRzI7sLvPC1/UTRQAUUUUAFfzT/Fb/glD+0x4z+JXifxVpUuhGz1bVbi8t2a62sY5ZNy/L/DX9LFFAHwP/wTu/Zv8dfsvfBLV/AHxEe0fVL/AMT3OsL9jl8xBDLaWdsnzf8Absa++KKKACiiigD4W/av/YL+EX7U1o+q6ih8O+Moo9lt4hs497kL0S5hLolwg/2iG/2q/Cz4hf8ABJT9rnwnqDQ+F9K03xjZ/wANxpt9bwt/wKO8a3av6vKKAP432/4J3/tfrc/Z2+HWqf7yxsU/76r2X4c/8EmP2tfGeorH4m0rTfBmn87rrVLyCUn2WGzeaX/vrbX9XdFAHw3+yl+wb8If2WLZdW0dX17xhNEY7nX7xAsgVsbo7eEFkgjJ/u/Me7V9yUUUAFFFFABX5r/te/8ABN/4V/tLz3PjPw9Ivg/x1Md82pQR5t71v+nuFfvN0/eL83+9X6UUUAfyZ+Nf+CUn7YvhXUntdJ8Naf4ptV5F9pWoWwiP/bO8a2uP/HK8uX/gnV+2G8pi/wCFdakv+0du2v7HaKAP5Z/hX/wSF/aX8Z34f4irp/gPTlf949xPFe3DL/0zhs3dP++nWv3s/Zm/ZC+Ef7K+gPpvgKzNxq94gXUdavNrXdz7bv8AlnHu6IvevqyigAooooAK/FD9v7/gn/8AGr9pb41xfEL4fT6SmnLpUFni8n8qUSxda/a+igD8af8Agnb+wX8Yf2W/jHrvj/4izaXJZah4an0eEWMxkfzZby1n+bj7u23r9lqKKACiiigAr8If22/+CcHx0/aA/aM8R/FfwJdaOmlazBYpGl3O0Uoa1s4bZvl/7Z1+71FAH5Hf8E5v2Jvi3+yv4w8Ta98R5tNe31fTVs7ZbKbzG3edHJ83/fNfrjRRQAV8v/tkfB3xJ8fP2b/GHwl8Iy20Wr68tiLd7xikQNtf29225l/2YTX1BRQB/L7Zf8Eef2oLK8huhf8Ahs+VIG/4+pP/AIiv6YPC+lTaJ4a0nRJ2Dy6fYW9q7r90mKNUYj8q6KigAooooA/nU/aB/wCCVf7QXxM+OHjv4h+Gr/Ql0rxP4hvdWtVnuGWVI7ydpfmXZ975q/Q3/gnX+yn8Rv2V/CPivQ/iNNp81xrN3bS232CRpFVIFm+8W95a/R6igAooooAK+Zf2iv2Ufg5+09oKaT8SdLLX9ojLp+r2h8q9td3/ADzk53Lu52NuWvzW/wCCvnxL+LPwq1f4Zap8NvF2v+FodSg1OCb+xr+ezWR4mtW+ZYCN3ytXyz+xl/wUd+NT/HLwn4R+N3jZ9R8E6tM9lePqEUG6OWSHbbzNdMnmqv2jb/HQB2/jz/giX8RbeYN8MviFomoQ9xrkNzYkf9+EvK4nRP8Agi3+0JcXUY1/xT4Rs7UH94YJ72SUj/ZH2PbX9NFFAH5tfsrf8E1PhF+zjqMXjHW7p/G/i+2ObbUryBYILX/r3tQ7qrcn5mdq/lX8deIG8VeMdY8RPGIv7RvJZ9gOQu5q/sH/AG2/2l9C/Zp+COt+IHvI08TaraT2Xhyzzl5bx12+bt/552+7zH+lfxrt5l5cHy4/mnfhUHdv4VoA/qM/4I4aVe6Z+ylqc15GY/7Q8Y3t1DnvF9i0+JW/8hmv1ir5S/Yk+GU3wi/ZZ+HXg69EiXq6QuoXaTLtljm1GRr54pP9qFp/L/4DX1bQAUUUUAFFFFABRRRQAUUUUAFFFFAH/9T9/KKKKACiiigAooooAKKKKACiiigAooooAKKKKACiiigAooooAKKKKACiiigAooooAKKKKACiiigAr8Ev+Cpn7Duv+ItZvf2mPhdayX8kkMa+J9LgXMoECrFHeQqOW+Rf3303f3q/e2igD+DjwX458Z/DbxBb+J/BWr32garanMd1ZSyQSj/gS1+kfhT/AILBftZ+GtMWz1X/AIRzxTc/8/Wr2LI3/fNhLZrX7g/Hn/gnv+zH8f7ubWvEnh2XRNduG3Tat4ddbO4k95FZJLeRv9p4mavi3xH/AMETfhZeoV8LfELWdKPY3dpDef8AoMttQB+bvxQ/4Kl/tZfEewk0e21618JWcybJh4eh+zyn/duH33Ef/AXr4E07S/FHj3xJDpmj215ruuavcbY7eBGnuLiZ+yqu52ZjX9H/AId/4It/AWzZD4o8W+ItT2dRZiCzDf8Afa3NfoV8Gf2WfgH8Ak3fC3wbp+lXoDKdSZWnvWV/vL9qnLyqrf3VYLQB8d/8E3P2Irn9nHwncfEP4kWyDx/4jgWIwfe/s2y+8sH/AF1lb5pvwX+9X6m0UUAFFFFABRRRQAUUUUAFFFFABRRRQAUUUUAFFFFABRRRQAUUUUAFFFFABRRRQAUUUUAFFFFABRRRQAUUUUAFFFFABRRRQAUUUUAFFFFABRRRQAUUUUAFFFFABRRRQAUUUUAFFFFABRRRQB8h/tnfswaT+1V8H7nwLJMljrlhL9v0O9cZWK6VWXbJ/wBM5R8r/hX8hXxK+GPjn4P+ML/wR4+0m40bWNNkxJFMOv8AdkVvuMr/AMDLX92NeSfFf4G/Cb45aH/wj3xX8L2HiKzAIiN0mJ4d38UFwmyeBveN1oA/lN+Dn/BRL9qX4M2EGhaP4tk1fRrVdkdhrKLeKi/wrHJKryxqvpvr2LxN/wAFe/2tdasfsukXOh+H5x/y82NjHI3/AHzdfaVr9OvEX/BG39mbVb+W+0bWvFGkCU7hapcW0kCH/ZV7bf8A+P1ztr/wRa+AgfOoeLvEjr6WnkQn/vqRJqAP52vH3xL8ffFTxDL4m+IGu6h4h1W4+Vp76eSZ/wDZVdx+VV/hWv1L/wCCdv8AwT9134p+ItI+NPxY002fgbT5FvNPs7lfm1aVG+X5Sv8Ax6fKc/3q/YH4R/8ABOT9lD4QTWuo6b4RGv6raj5L/wAQyNevn/rj8lr/AOQq+7KACiiigAooooAKKKKACiiigAooooAKKKKAP//V/fyiiigAooooAKKKKACiiigAooooAKKKKACiiigAooooAKKKKACiiigAooooAKKKKACiiigAooooAKKKKACiiigAooooAKKKKACiiigAooooAKKKKACiiigAooooAKKKKACiiigAooooAKKKKACiiigAooooAKKKKACiiigAooooAKKKKACiiigAooooAKKKKACiiigAooooAKKKKACiiigAooooAKKKKACiiigAooooAKKKKACiiigAooooAKKKKACiiigAooooAKKKKACiiigAooooA//Z";
const String logoMimeType = "image/jpg"; // image/jpeg, je nach Dateityp

// ---------- Helfer -----------------------------
// distance in cm, return volume in Liter
float calculateVolume(float distance) {
    if(isnan(d_leer) || isnan(d_voll) || isnan(diameter) || isnan(distance)) return NAN;
    float pi = 3.141592;
    float hi = max(d_leer, d_voll);              // "leer" = groesste Distanz (Referenz)
    float lo = min(d_leer, d_voll);              // "voll" = kleinste Distanz
    float height = (hi - distance) / 10;         // Wassersaeule in dm
    if (height < 0) height = 0;                  // unter "leer": 0 statt negativ
    float maxH = (hi - lo) / 10;
    if (height > maxH) height = maxH;            // ueber "voll": auf max gedeckelt
    float diameter_l = diameter / 10;
    return ((diameter_l * diameter_l * pi) / 4) * height;
}

float medianOf(uint32_t *arr, uint8_t n) {
  for (uint8_t i = 0; i < n - 1; ++i) {
    uint8_t minIdx = i;
    for (uint8_t j = i + 1; j < n; ++j) if (arr[j] < arr[minIdx]) minIdx = j;
    if (minIdx != i) { uint32_t t = arr[i]; arr[i] = arr[minIdx]; arr[minIdx] = t; }
  }
  return (n & 1) ? arr[n/2] : 0.5f * (arr[n/2 - 1] + arr[n/2]);
}

float measureDistance() {
  uint32_t valid[SAMPLES];   // nur erfolgreich gemessene Echos
  uint8_t  validCount = 0;
  for (uint8_t i = 0; i < SAMPLES; ++i) {
    g_echoReady = false;
    g_echoStart = 0;
    digitalWrite(PIN_TRIG, LOW);  delayMicroseconds(2);
    digitalWrite(PIN_TRIG, HIGH); delayMicroseconds(10);
    digitalWrite(PIN_TRIG, LOW);
    // Tight-Loop: kein yield() damit WiFi-Tasks keine ISR-Flanke verdecken
    uint32_t deadline = micros() + ULTRASONIC_TIMEOUT;
    while (!g_echoReady && (int32_t)(micros() - deadline) < 0) { /* busy wait */ }
    g_lastSamples[i] = g_echoReady ? g_echoDur : ULTRASONIC_TIMEOUT; // Debug: roh inkl. Timeouts
    if (g_echoReady) valid[validCount++] = g_echoDur;                // nur echte Echos in den Pool
    delay(35); // WiFi bekommt Zeit zwischen den Samples
  }
  g_lastValidCount = validCount;
  // Qualitaets-Gate: weniger als die Haelfte gueltige Echos -> keine verlaessliche Messung.
  if (validCount < SAMPLES / 2) return NAN;
  medianOf(valid, validCount); // sortiert in-place (Rueckgabe hier egal)

  // Cluster-Schaetzer statt globalem Median:
  // Echte Echos von einer Oberflaeche liegen eng beieinander (wenige cm),
  // Multipath-/Stoerechos streuen breit und liegen typisch NAEHER als das
  // Ziel. Ein globaler Median mischt beide Gipfel und "wandert" mit dem
  // Mischverhaeltnis (beobachtet: 241cm -> 122cm Drift).
  // Schritt 1: zusammenhaengende Gruppen finden (Nachbar-Gap <= max(5%, 10cm))
  uint8_t cStart[SAMPLES], cLenArr[SAMPLES], cCount = 0;
  uint8_t curStart = 0, curLen = 1;
  for (uint8_t i = 1; i < validCount; ++i) {
    uint32_t gap = valid[i] - valid[i-1];
    uint32_t thr = valid[i-1] / 20;              // 5% relativ ...
    if (thr < 580) thr = 580;                    // ... mindestens 10cm (580us)
    if (gap <= thr) {
      curLen++;
    } else {
      cStart[cCount] = curStart; cLenArr[cCount] = curLen; cCount++;
      curStart = i; curLen = 1;
    }
  }
  cStart[cCount] = curStart; cLenArr[cCount] = curLen; cCount++;

  uint8_t bestLen = 0;
  for (uint8_t c = 0; c < cCount; ++c) if (cLenArr[c] > bestLen) bestLen = cLenArr[c];
  g_lastClusterLen = bestLen;
  // Kein dominantes Cluster (alles verstreut) -> keine vertrauenswuerdige Messung
  if (bestLen < 4) return NAN;

  // Schritt 2 (an realen Messreihen verifiziert): unter allen Clustern mit
  // Laenge >= 3/4 des groessten gewinnt das FERNSTE. Grund: Stoerbaender
  // haben oft 1-2 Samples mehr als das echte Ziel, liegen aber naeher und
  // breiter. Reines "groesstes Cluster" lieferte auf realen Daten 165cm
  // statt 241cm; diese Regel trifft beide realen Sets korrekt.
  uint8_t need = bestLen - bestLen / 4;
  if (need < 4) need = 4;
  uint8_t sel = 0;
  for (uint8_t c = 0; c < cCount; ++c) if (cLenArr[c] >= need) sel = c; // letztes qualifiziertes = fernstes
  g_lastClusterLen = cLenArr[sel];

  float us = medianOf(valid + cStart[sel], cLenArr[sel]); // Median des Gewinner-Clusters
  float cm = us / 58.0f;
  if (cm < SENSOR_MIN_CM) return NAN;
  return cm;
}

float computePercent(float d) {
  if (isnan(d) || isnan(d_leer) || isnan(d_voll)) return NAN;
  float hi = max(d_leer, d_voll);
  float lo = min(d_leer, d_voll);
  if (hi == lo) return NAN;
  float p = 100.0f * (hi - d) / (hi - lo);
  if (p < 0) p = 0;
  if (p > 100) p = 100;
  return p;
}

// ---------- Persistenz --------------------------
void loadPersist() {
  prefs.begin("fuell", true);
  d_leer = prefs.getFloat("leer", NAN);
  d_voll = prefs.getFloat("voll", NAN);
  diameter = prefs.getFloat("diameter", NAN);
  publishEnabled = prefs.getBool("pub", false);
  analogOutputEnabled = prefs.getBool("analog", false);
  autoUpdateEnabled = prefs.getBool("autoupd", false);
  prefs.end();
}
void savePersist() {
  // Invariante d_leer >= d_voll in JEDEM Kalibrierpfad sicherstellen (auch Capture-Buttons),
  // sonst rechnet calculateVolume mit vertauschter Referenz.
  if(!isnan(d_leer) && !isnan(d_voll) && d_voll > d_leer){
    float t = d_leer; d_leer = d_voll; d_voll = t;
  }
  prefs.begin("fuell", false);
  prefs.putFloat("leer", d_leer);
  prefs.putFloat("voll", d_voll);
  prefs.putFloat("diameter", diameter);
  prefs.putBool("pub", publishEnabled);
  prefs.putBool("analog", analogOutputEnabled);
  prefs.putBool("autoupd", autoUpdateEnabled);
  prefs.end();
}
void loadWifiCreds() {
  prefs.begin("net", true);
  sta_ssid = prefs.getString("ssid", "");
  sta_pass = prefs.getString("pass", "");
  staEnabled = prefs.getBool("en", true);
  prefs.end();
}
void saveWifiCreds() {
  prefs.begin("net", false);
  prefs.putString("ssid", sta_ssid);
  prefs.putString("pass", sta_pass);
  prefs.putBool("en", staEnabled);
  prefs.end();
}

// ---------- WLAN -------------------------------
void startAP() {
  WiFi.mode(WIFI_AP_STA);
  WiFi.softAPConfig(IPAddress(192,168,4,1), IPAddress(192,168,4,1), IPAddress(255,255,255,0)); // Feste IP
  WiFi.softAP(AP_SSID, AP_PASS, 6, 0, 4); // Kanal 6, nicht versteckt, max 4 Clients
  delay(100); // Warte auf Stabilisierung
  Serial.println("[AP] gestartet: " + String(AP_SSID) + " IP: " + WiFi.softAPIP().toString());
}

void connectSTA() {
  if (!staEnabled || !sta_ssid.length()) return;
  WiFi.mode(WIFI_AP_STA);
  WiFi.disconnect(false, false); // nur STA trennen, AP bleibt
  delay(50);
  Serial.println("[STA] Starte Verbindung zu '" + sta_ssid + "' …");
  WiFi.begin(sta_ssid.c_str(), sta_pass.c_str());
  // nicht blockierend – loop() erkennt WL_CONNECTED und richtet mDNS ein
}

// ---------- HTML -------------------------------
String htmlEncode(const String &s) {
  String r = s;
  r.replace("&", "&amp;");
  r.replace("<", "&lt;");
  r.replace(">", "&gt;");
  r.replace("\"", "&quot;");
  r.replace("'", "&#39;");
  return r;
}

String htmlHeader(const String &title) {
  String h = "<!DOCTYPE html><html><head><meta charset='utf-8'><meta name='viewport' content='width=device-width,initial-scale=1'>";
  h += "<title>" + title + "</title><style>body{font-family:Arial,Helvetica,sans-serif;max-width:640px;margin:1rem;}button,input{padding:8px;margin:4px;width:100%;box-sizing:border-box;}div.card{border:1px solid #ccc;padding:14px;margin:16px 0;border-radius:8px;}h1{font-size:1.4rem;margin:0 0 1rem;}footer{font-size:.75rem;color:#666;margin-top:1.5rem;}small{display:block;margin-top:6px;color:#555;}</style></head><body>";
  if (logoBase64.length() > 0) {
    h += "<img src='data:" + logoMimeType + ";base64," + logoBase64 + "' alt='Logo' style='max-width:200px; display:block; margin:0 auto 1rem;'>";
  }
  h += "<h1>Zisternenfüllstand</h1>";
  return h;
}
String htmlFooter() {
  String f = "<footer>STA: " + (WiFi.status() == WL_CONNECTED ? WiFi.localIP().toString() : String("--"));
  f += " | AP: " + WiFi.softAPIP().toString();
  f += " | v" FW_VERSION;
  f += " | <a href='/update'>Update</a>";
  f += " | <a href='/doku' target='_blank'>Doku</a>";
  f += "</footer></body></html>";
  return f;
}

// ---------- Webhandler --------------------------
void pageRoot() {
  String pg = htmlHeader("Status");
  pg += "<div class='card'><h2>Status</h2>";
  pg += "Distanz: <b>" + (isnan(lastDist) ? String("--") : String(lastDist, 1) + " cm") + "</b><br>";
  pg += "Füllstand: <b>" + (isnan(lastPerc) ? String("--") : String(lastPerc, 1) + " %") + "</b><br>";
  pg += "Volumen: <b>" + (isnan(volume) ? String("--") : String(volume, 1) + " Liter") + "</b><br>";
  pg += "<p><a href='/config'><button>Konfiguration</button></a></p></div>";
  pg += htmlFooter();
  server.send(200, "text/html", pg);
}

void pageConfig() {
  // WiFi-Status für Anzeige auswerten
  wl_status_t ws = (wl_status_t)WiFi.status();
  String wifiStatusHtml;
  bool connecting = false;
  switch (ws) {
    case WL_CONNECTED:
      wifiStatusHtml = "<span style='color:green'>&#10003; Verbunden &ndash; IP: <b>"
                       + WiFi.localIP().toString() + "</b></span>";
      break;
    case WL_NO_SSID_AVAIL:
      wifiStatusHtml = "<span style='color:red'>&#10007; SSID nicht gefunden</span>";
      break;
    case WL_CONNECT_FAILED:
      wifiStatusHtml = "<span style='color:red'>&#10007; Verbindung fehlgeschlagen (Passwort?)</span>";
      break;
    default:
      if (staEnabled && sta_ssid.length()) {
        wifiStatusHtml = "<span style='color:orange'>&#9679; Verbinde mit &laquo;"
                         + htmlEncode(sta_ssid) + "&raquo;&hellip;</span>";
        connecting = true;
      } else {
        wifiStatusHtml = "<span style='color:gray'>Nicht konfiguriert</span>";
      }
  }

  String pg = htmlHeader("Konfiguration");
  if (connecting) pg += "<meta http-equiv='refresh' content='4'>";
  // WLAN
  pg += "<div class='card'><h2>Heim-WLAN</h2>";
  pg += "Status: " + wifiStatusHtml + "<br><br>";
  pg += "<form method='POST' action='/wifi'>";
  pg += "SSID:<input name='ssid' value='" + htmlEncode(sta_ssid) + "'/><br>";
  pg += "Passwort:<input type='password' name='pass' value='" + sta_pass + "'/><br>";
  pg += "<button type='submit'>Speichern &amp; Verbinden</button></form>";
  pg += "Client-Modus: <b>" + String(staEnabled?"AN":"AUS") + "</b> ";
  pg += "<form method='POST' action='/sta' style='display:inline'><button style='width:auto'>"
        + String(staEnabled?"Deaktivieren":"Aktivieren") + "</button></form></div>";
  // Kalibrierung
  pg += "<div class='card'><h2>Kalibrierung</h2>";
  if (server.arg("err") == "leer" || server.arg("err") == "voll")
    pg += "<p style='color:red'>&#9888; Messung fehlgeschlagen (kein Echo oder Blindzone) – "
          "der gespeicherte Wert wurde NICHT ge&auml;ndert. Bei sehr kurzer Distanz bitte manuell eingeben.</p>";
  pg += "Leer: <b>" + (isnan(d_leer) ? String("--") : String(d_leer, 1)) + " cm</b><br>";
  pg += "Voll: <b>" + (isnan(d_voll) ? String("--") : String(d_voll, 1)) + " cm</b><br>";
  pg += "Durchmesser: <b>" + (isnan(diameter) ? String("--") : String(diameter, 1)) + " cm</b><br>";
  if (!isnan(d_voll) && d_voll < SENSOR_MIN_CM)
    pg += "<p style='color:red'>&#9888; Voll-Wert liegt in der Blindzone des Sensors (&lt;"
          + String(SENSOR_MIN_CM, 0) + " cm) – Messung unzuverl&auml;ssig!</p>";
  pg += "<form method='POST' action='/set_leer'><button>Setze LEER = aktuelle Distanz</button></form>";
  pg += "<form method='POST' action='/set_voll'><button>Setze VOLL = aktuelle Distanz</button></form>";
  pg += "<form method='POST' action='/set_manual'>";
  pg += "Manuell setzen:<br>Leer (cm): <input name='leer_val' type='number' step='0.1' value='" + (isnan(d_leer) ? String("") : String(d_leer, 1)) + "'/><br>";
  pg += "Voll (cm): <input name='voll_val' type='number' step='0.1' value='" + (isnan(d_voll) ? String("") : String(d_voll, 1)) + "'/><br>";
  pg += "Durchmesser (cm): <input name='diameter_val' type='number' step='0.1' value='" + (isnan(diameter) ? String("") : String(diameter, 1)) + "'/><br>";
  pg += "<button type='submit'>Speichern</button></form></div>";
  pg += "<div class='card'><h2>Publishing</h2>";
  pg += "Status: <b>" + String(publishEnabled?"AN":"AUS") + "</b><br>";
  pg += "<form method='POST' action='/publish'><button>" + String(publishEnabled?"Deaktivieren":"Aktivieren") + " Publishing</button></form></div>";
  pg += "<div class='card'><h2>Analogausgang</h2>";
  pg += "Aktiv: <b>" + String(analogOutputEnabled?"JA":"NEIN") + "</b><br>";
  pg += "<form method='POST' action='/analog'><button>" + String(analogOutputEnabled?"Deaktivieren":"Aktivieren") + " DAC-Ausgabe</button></form>";
  pg += "<small>Gibt den Füllstand 0–100% als 0–3,3V über DAC1 (GPIO25) aus.</small>";
  pg += "</div>";
  pg += "<div class='card'><h2>Firmware</h2>";
  pg += "Version: <b>" FW_VERSION "</b><br>";
  pg += "Auto-Update: <b>" + String(autoUpdateEnabled ? "AN" : "AUS") + "</b>";
  pg += "<small> (pr&uuml;ft st&uuml;ndlich auf neue Version)</small><br>";
  pg += "<form method='POST' action='/autoupdate'><button>" + String(autoUpdateEnabled ? "Deaktivieren" : "Aktivieren") + " Auto-Update</button></form>";
  pg += "<a href='/update'><button>Jetzt manuell aktualisieren</button></a>";
  pg += "</div>";
  pg += "<p><a href='/'>← Zurück</a></p>";
  pg += htmlFooter();
  server.send(200, "text/html", pg);
}

void handleWifi(){
  if(server.hasArg("ssid") && server.hasArg("pass")){
    sta_ssid = server.arg("ssid");
    sta_pass = server.arg("pass");
    saveWifiCreds();
    connectSTA();
  }
  server.sendHeader("Location", "/config");
  server.send(303);
}

void handleStaToggle(){
  staEnabled = !staEnabled;
  saveWifiCreds();
  if(staEnabled){
    connectSTA();
  } else {
    WiFi.disconnect(false, false);
    mdnsStarted = false;
  }
  server.sendHeader("Location", "/config");
  server.send(303);
}

void handleSetLeer(){
  float d = measureDistance();
  if(isnan(d)){ server.sendHeader("Location", "/config?err=leer"); server.send(303); return; }
  d_leer = d;
  savePersist();
  server.sendHeader("Location", "/config");
  server.send(303);
}

void handleSetVoll(){
  float d = measureDistance();
  if(isnan(d)){ server.sendHeader("Location", "/config?err=voll"); server.send(303); return; }
  d_voll = d;
  savePersist();
  server.sendHeader("Location", "/config");
  server.send(303);
}

void handleSetManual(){
  if(server.hasArg("leer_val") && server.hasArg("voll_val") && server.hasArg("diameter_val"))
  {
    float leer = server.arg("leer_val").toFloat();
    float voll = server.arg("voll_val").toFloat();
    float d = server.arg("diameter_val").toFloat();
    if(!isnan(leer)) d_leer = leer;
    if(!isnan(voll)) d_voll = voll;
    if(!isnan(d)) diameter = d;
  }
  else {
    if(server.hasArg("leer_val")){
    float v = server.arg("leer_val").toFloat();
    if(!isnan(v)) d_leer = v;
    }
    if(server.hasArg("voll_val")){
      float v = server.arg("voll_val").toFloat();
      if(!isnan(v)) d_voll = v;
    }
    if(server.hasArg("diameter_val")){
      float v = server.arg("diameter_val").toFloat();
      if(!isnan(v)) diameter = v;
    }
  }
  if(d_voll > d_leer){ float t = d_leer; d_leer = d_voll; d_voll = t; }
  savePersist();
  server.sendHeader("Location", "/config");
  server.send(303);
}

void handlePublish(){
  publishEnabled = !publishEnabled;
  savePersist();
  server.sendHeader("Location", "/config");
  server.send(303);
}

void handleDebug(){
  String j = "{\"samples_us\":[";
  for (uint8_t i = 0; i < SAMPLES; ++i) {
    j += String(g_lastSamples[i]);
    if (i < SAMPLES-1) j += ",";
  }
  j += "],\"computed_cm\":" + (isnan(lastDist) ? String("null") : String(lastDist,2));
  j += ",\"sensor_min_cm\":" + String(SENSOR_MIN_CM,0);
  j += ",\"timeout_us\":" + String(ULTRASONIC_TIMEOUT);
  // ISR-Diagnose: keine Flanken = Verkabelung/Versorgung; nur rejected = Blindzone/Resonanz
  j += ",\"isr_rising\":" + String(g_isrRising);
  j += ",\"isr_falling\":" + String(g_isrFalling);
  j += ",\"isr_rejected_short\":" + String(g_isrRejected);
  j += ",\"last_rejected_us\":" + String(g_lastRejectedUs);
  j += ",\"valid_count\":" + String(g_lastValidCount) + ",\"samples_total\":" + String(SAMPLES);
  j += ",\"cluster_size\":" + String(g_lastClusterLen);
  j += ",\"echo_pin_level\":" + String(digitalRead(PIN_ECHO));
  j += ",\"last_good_age_ms\":" + String(lastGoodMeasure ? (millis() - lastGoodMeasure) : 0);
  j += ",\"fw\":\"" FW_VERSION "\"";
  j += "}";
  server.send(200, "application/json", j);
}

void pageMeasure(){
  float d = measureDistance();
  float p = computePercent(d);
  float vol = calculateVolume(d);
  String pg = htmlHeader("Messung");
  pg += "<div class='card'><h2>Einzelmessung</h2>";
  pg += "Distanz: <b>" + (isnan(d)? String("--") : String(d,1) + " cm") + "</b><br>";
  pg += "Füllstand: <b>" + (isnan(p)? String("--") : String(p,1)) + " %</b><br>";
  pg += "Volumen: <b>" + (isnan(vol)? String("--") : String(vol,1)) + " Liter</b></div>";
  pg += "<p><a href='/'>";
  pg += "<button>Zurück</button></a></p>";
  pg += htmlFooter();
  server.send(200, "text/html", pg);
}

void handleStatusAPI(){
  if(!publishEnabled){
    server.send(403, "application/json", "{\"error\":\"publishing disabled\"}");
    return;
  }
  float d = lastDist;
  float p = lastPerc;
  String json = "{";
  json += "\"distance_cm\":" + (isnan(d)? String("null") : String(d,2)) + ",";
  json += "\"percent\":" + (isnan(p)? String("null") : String(p,2)) + ",";
  json += "\"analog_output\":" + String(analogOutputEnabled?"true":"false") + ",";
  json += "\"volumen\":" + (isnan(volume)? String("null") : String(volume,2)) + ",";
  // age_ms = Alter der letzten gueltigen Messung; valid=false signalisiert haengenden Sensor
  unsigned long age = lastGoodMeasure ? (millis() - lastGoodMeasure) : 0;
  bool valid = !isnan(d) && lastGoodMeasure && (age <= MEASURE_STALE_MS);
  json += "\"valid\":" + String(valid?"true":"false") + ",";
  json += "\"age_ms\":" + String(age) + ",";
  json += "\"timestamp_ms\":" + String(millis());
  json += "}";
  server.send(200, "application/json", json);
}

void notFound(){ server.send(404, "text/plain", "Not Found"); }

void handleAnalogToggle(){
  analogOutputEnabled = !analogOutputEnabled;
  savePersist();
  server.sendHeader("Location", "/config");
  server.send(303);
}

void handleDoku() {
  server.send(200, "text/html; charset=utf-8", R"HTML(<!DOCTYPE html><html><head><meta charset='utf-8'>
<meta name='viewport' content='width=device-width,initial-scale=1'>
<title>Bedienungsanleitung – Zisternenfüllstand</title>
<style>
body{font-family:Arial,Helvetica,sans-serif;max-width:720px;margin:1rem auto;padding:0 1rem;line-height:1.5;}
h1{font-size:1.5rem;border-bottom:2px solid #0077cc;padding-bottom:.4rem;}
h2{font-size:1.2rem;border-bottom:1px solid #ccc;padding-bottom:.2rem;margin-top:2rem;}
h3{font-size:1rem;margin-top:1.5rem;}
h4{font-size:.95rem;margin-top:1rem;}
table{border-collapse:collapse;width:100%;margin:.5rem 0;}
th,td{border:1px solid #ccc;padding:6px 10px;text-align:left;}
th{background:#f0f0f0;}
code{background:#f4f4f4;padding:1px 4px;border-radius:3px;font-size:.9em;}
pre{background:#f4f4f4;padding:10px;border-radius:4px;overflow-x:auto;}
blockquote{border-left:3px solid #0077cc;margin:0;padding:.3rem .8rem;background:#f0f8ff;}
hr{border:none;border-top:1px solid #ddd;margin:1.5rem 0;}
ul,ol{padding-left:1.5rem;}
</style></head><body>
<h1>Zisternenfüllstand &#8211; Bedienungsanleitung</h1>
<p><strong>Version )HTML" FW_VERSION R"HTML( | Zisternenfüllstand-Gerät</strong></p>
<hr>
<h2>Was macht dieses Gerät?</h2>
<p>Das Gerät misst den Wasserstand in Ihrer Zisterne automatisch alle 2 Sekunden und zeigt das Ergebnis als:</p>
<ul><li><strong>Prozentwert</strong> (z.&nbsp;B. „75&nbsp;% voll")</li>
<li><strong>Liter</strong> (z.&nbsp;B. „1.500 Liter")</li></ul>
<p>Die Messung erfolgt berührungslos mit einem Ultraschallsensor. Sie können das Gerät über jeden Webbrowser (Smartphone, Tablet, PC) bedienen und konfigurieren.</p>
<hr>
<h2>Technische Übersicht</h2>
<table><tr><th>Komponente</th><th>Details</th></tr>
<tr><td>Mikrocontroller</td><td>ESP32</td></tr>
<tr><td>Sensor</td><td>Ultraschall JSN-SR04T</td></tr>
<tr><td>Trigger-Pin</td><td>GPIO 16</td></tr>
<tr><td>Echo-Pin</td><td>GPIO 4 (über Spannungsteiler)</td></tr>
<tr><td>Analogausgang</td><td>GPIO 25 (DAC, 0–3,3&nbsp;V)</td></tr>
<tr><td>WLAN</td><td>2,4&nbsp;GHz, AP + STA gleichzeitig</td></tr>
<tr><td>Web-Oberfläche</td><td>Port 80, mDNS: <code>zisterne.local</code></td></tr></table>
<hr>
<h2>Inbetriebnahme – Schritt für Schritt</h2>
<h3>Schritt 1: Gerät einschalten</h3>
<p>Schließen Sie das Gerät an die Stromversorgung an (5&nbsp;V). Das Gerät startet automatisch.</p>
<blockquote><strong>Wichtig:</strong> Nach dem Einschalten öffnet das Gerät automatisch für <strong>10 Minuten</strong> einen eigenen WLAN-Zugangspunkt (Access Point).</blockquote>
<h3>Schritt 2: Mit dem Gerät verbinden</h3>
<ol><li>WLAN-Einstellungen öffnen</li>
<li>Netzwerk <code>CONFIG_ZISTERNE_AP</code> auswählen</li>
<li>Passwort: <code>12345678</code></li>
<li>Browser öffnen: <a href='http://192.168.4.1'>http://192.168.4.1</a></li></ol>
<h3>Schritt 3: Heim-WLAN einrichten</h3>
<ol><li>Klicken Sie auf <strong>„Konfiguration"</strong></li>
<li>Im Abschnitt <strong>„Heim-WLAN"</strong>: SSID und Passwort eingeben</li>
<li>Klicken Sie <strong>„Speichern &amp; Verbinden"</strong></li></ol>
<p>Das Gerät ist danach über <a href='http://zisterne.local'>http://zisterne.local</a> erreichbar.</p>
<blockquote><strong>Tipp:</strong> Die IP-Adresse steht im Footer der Webseite – als Alternative zu <code>zisterne.local</code>.</blockquote>
<h3>Schritt 4: Sensor kalibrieren</h3>
<p>Gehen Sie zu <strong>Konfiguration → Kalibrierung</strong>.</p>
<h4>Option A: Automatisch (einfach)</h4>
<ol><li><strong>Leerer Zustand:</strong> Zisterne leer → <strong>„Setze LEER = aktuelle Distanz"</strong></li>
<li><strong>Voller Zustand:</strong> Zisterne voll → <strong>„Setze VOLL = aktuelle Distanz"</strong></li></ol>
<h4>Option B: Manuell (mit Maßband)</h4>
<ol><li><strong>Leer (cm):</strong> Distanz Sensor bis Boden (z.&nbsp;B. <code>320</code>)</li>
<li><strong>Voll (cm):</strong> Distanz Sensor bis max. Wasserstand (z.&nbsp;B. <code>30</code>)</li>
<li><strong>Durchmesser (cm):</strong> Innendurchmesser der Zisterne (z.&nbsp;B. <code>150</code>)</li>
<li>Klicken Sie <strong>„Speichern"</strong></li></ol>
<blockquote>Der Leer-Wert ist immer größer als der Voll-Wert.</blockquote>
<h3>Schritt 5: Optionale Funktionen</h3>
<h4>API / Smart-Home-Integration</h4>
<p>Aktivieren Sie <strong>„Publishing"</strong> – dann ist der Füllstand abrufbar unter:</p>
<pre>http://zisterne.local/api/status</pre>
<p>Antwort:</p>
<pre>{"distance_cm":150.5,"percent":75.0,"analog_output":true,"volumen":1250.30,"valid":true,"age_ms":340,"timestamp_ms":123456789}</pre>
<p><code>valid:false</code> oder ein gro&szlig;es <code>age_ms</code> bedeutet: Sensor liefert aktuell keine g&uuml;ltige Messung (z.&nbsp;B. abgesteckt).</p>
<p>Kompatibel mit Home Assistant, ioBroker, Loxone u.&nbsp;a.</p>
<h4>Analogausgang (0–3,3&nbsp;V an GPIO 25)</h4>
<p>Aktivieren Sie <strong>„DAC-Ausgabe"</strong>:<br>0&nbsp;V = leer (0&nbsp;%), 3,3&nbsp;V = voll (100&nbsp;%)</p>
<hr>
<h2>Firmware aktualisieren</h2>
<h3>Via Web-Browser</h3>
<table><tr><th>Feld</th><th>Wert</th></tr>
<tr><td>Benutzername</td><td><code>admin</code></td></tr>
<tr><td>Passwort</td><td><code>zisternenfuellstand</code></td></tr></table>
<ol><li><a href='/update'>http://zisterne.local/update</a> öffnen</li>
<li>Benutzername und Passwort eingeben</li>
<li><code>firmware.bin</code> auswählen → <strong>„Hochladen &amp; Flashen"</strong></li></ol>
<h3>Automatisches Update</h3>
<p>Aktivieren Sie unter <strong>Konfiguration → Auto-Update</strong> – das Gerät prüft stündlich auf neue Versionen und aktualisiert sich selbst.</p>
<h3>Via Arduino IDE</h3>
<p>Das Gerät erscheint unter <strong>Werkzeuge → Port</strong> als <code>zisterne</code>. Passwort: <code>zisternenfuellstand</code></p>
<hr>
<h2>Statusseite – Was bedeutet was?</h2>
<table><tr><th>Anzeige</th><th>Bedeutung</th></tr>
<tr><td>Distanz: <code>--</code></td><td>Sensor liefert kein Signal</td></tr>
<tr><td>Füllstand: <code>--</code></td><td>Kalibrierung fehlt (Schritt 4)</td></tr>
<tr><td>Volumen: <code>--</code></td><td>Durchmesser nicht konfiguriert</td></tr>
<tr><td>Füllstand: <code>0 %</code></td><td>Zisterne leer</td></tr>
<tr><td>Füllstand: <code>100 %</code></td><td>Zisterne voll</td></tr></table>
<hr>
<h2>Fehlerbehebung</h2>
<table><tr><th>Problem</th><th>Lösung</th></tr>
<tr><td>Webseite nicht erreichbar</td><td>Gerät neu starten, mit <code>CONFIG_ZISTERNE_AP</code> verbinden, <code>192.168.4.1</code> aufrufen</td></tr>
<tr><td><code>zisterne.local</code> funktioniert nicht</td><td>IP-Adresse aus dem Footer direkt eingeben</td></tr>
<tr><td>Füllstand springt stark</td><td>Sensor nicht fest montiert oder Wasser bewegt – kurz warten</td></tr>
<tr><td>WLAN-Verbindung schlägt fehl</td><td>SSID und Passwort prüfen – Gerät versucht alle 2 Minuten neu</td></tr>
<tr><td>Nach Update kein Zugriff</td><td>Gerät neu starten (Strom kurz trennen)</td></tr>
<tr><td>Sensor zeigt falschen Wert</td><td>Sensorversorgung auf 5&nbsp;V prüfen – JSN-SR04T benötigt zwingend 5&nbsp;V</td></tr></table>
<hr>
<p style='font-size:.8rem;color:#666;'>Autor: Matthias Lauß &nbsp;|&nbsp; Lizenz: MIT &nbsp;|&nbsp; Firmware )HTML" FW_VERSION R"HTML(</p>
</body></html>)HTML");
}

void handleAutoUpdateToggle(){
  autoUpdateEnabled = !autoUpdateEnabled;
  savePersist();
  server.sendHeader("Location", "/config");
  server.send(303);
}

void checkAndApplyOTA() {
  if (WiFi.status() != WL_CONNECTED) return;
  Serial.println("[AutoOTA] Prüfe auf neue Firmware...");
  WiFiClientSecure client;
  client.setInsecure(); // kein Zertifikats-Check – akzeptabler Trade-off für lokales IoT-Gerät
  HTTPClient http;
  http.begin(client, OTA_VERSION_URL);
  http.setFollowRedirects(HTTPC_STRICT_FOLLOW_REDIRECTS);
  int code = http.GET();
  if (code == 200) {
    String remote = http.getString();
    remote.trim();
    Serial.println("[AutoOTA] Remote: " + remote + " | Lokal: " FW_VERSION);
    if (remote.length() > 0 && remote != FW_VERSION) {
      Serial.println("[AutoOTA] Neue Version verfügbar – starte Update...");
      http.end();
      WiFiClientSecure uc;
      uc.setInsecure();
      httpUpdate.rebootOnUpdate(true);
      t_httpUpdate_return ret = httpUpdate.update(uc, OTA_FIRMWARE_URL);
      if (ret == HTTP_UPDATE_FAILED) {
        Serial.println("[AutoOTA] Fehler: " + httpUpdate.getLastErrorString());
      }
      return;
    } else {
      Serial.println("[AutoOTA] Firmware ist aktuell.");
    }
  } else {
    Serial.println("[AutoOTA] Versionsprüfung fehlgeschlagen: HTTP " + String(code));
  }
  http.end();
}

void pageUpdate() {
  if (!server.authenticate(OTA_WEB_USER, OTA_WEB_PASS)) return server.requestAuthentication();
  String pg = htmlHeader("Firmware Update");
  pg += "<div class='card'><h2>Firmware aktualisieren</h2>";
  pg += "<p>Aktuelle Version: <b>" FW_VERSION "</b></p>";
  pg += "<p>Laden Sie die neue .bin-Datei herunter und w&auml;hlen Sie sie hier aus:</p>";
  pg += "<form method='POST' action='/do_update' enctype='multipart/form-data'>";
  pg += "<input type='file' name='firmware' accept='.bin' style='margin-bottom:8px'/><br>";
  pg += "<button type='submit'>Hochladen &amp; Flashen</button>";
  pg += "</form><small>Das Ger&auml;t startet nach dem Update automatisch neu. Seite nicht schlie&szlig;en!</small></div>";
  pg += "<p><a href='/config'>&#8592; Zur&uuml;ck</a></p>";
  pg += htmlFooter();
  server.send(200, "text/html", pg);
}

void handleUpdateDone() {
  if (!server.authenticate(OTA_WEB_USER, OTA_WEB_PASS)) return server.requestAuthentication();
  bool ok = !Update.hasError();
  String pg = htmlHeader("Firmware Update");
  pg += "<div class='card'>";
  if (ok) {
    pg += "<h2>Update erfolgreich!</h2><p>Das Ger&auml;t startet in 5 Sekunden neu.</p>";
  } else {
    pg += "<h2>Update fehlgeschlagen!</h2><p>Bitte erneut versuchen.</p>";
  }
  pg += "</div><script>setTimeout(()=>location.href='/',5000);</script>";
  pg += htmlFooter();
  server.sendHeader("Connection", "close");
  server.send(200, "text/html", pg);
  if (ok) { delay(1000); ESP.restart(); }
}

void handleUpdateUpload() {
  HTTPUpload &upload = server.upload();
  if (upload.status == UPLOAD_FILE_START) {
    Serial.printf("[OTA] Upload: %s\n", upload.filename.c_str());
    if (!Update.begin(UPDATE_SIZE_UNKNOWN)) Update.printError(Serial);
  } else if (upload.status == UPLOAD_FILE_WRITE) {
    if (Update.write(upload.buf, upload.currentSize) != upload.currentSize) Update.printError(Serial);
  } else if (upload.status == UPLOAD_FILE_END) {
    if (Update.end(true)) Serial.printf("[OTA] OK: %u bytes\n", upload.totalSize);
    else Update.printError(Serial);
  }
}

void setup(){
  Serial.begin(115200);
  delay(200);
  pinMode(PIN_TRIG, OUTPUT);
  pinMode(PIN_ECHO, INPUT);
  attachInterrupt(digitalPinToInterrupt(PIN_ECHO), echoISR, CHANGE);
  loadPersist();
  loadWifiCreds();
  startAP();
  apExpires = millis() + AP_GRACE_PERIOD;
  if(staEnabled) connectSTA();

  server.on("/", pageRoot);
  server.on("/config", pageConfig);
  server.on("/wifi", HTTP_POST, handleWifi);
  server.on("/sta", HTTP_POST, handleStaToggle);
  server.on("/set_leer", HTTP_POST, handleSetLeer);
  server.on("/set_voll", HTTP_POST, handleSetVoll);
  server.on("/set_manual", HTTP_POST, handleSetManual);
  server.on("/publish", HTTP_POST, handlePublish);
  server.on("/measure", pageMeasure);
  server.on("/debug", handleDebug);
  server.on("/analog", HTTP_POST, handleAnalogToggle);
  server.on("/autoupdate", HTTP_POST, handleAutoUpdateToggle);
  server.on("/doku", handleDoku);
  server.on("/api/status", handleStatusAPI);
  server.on("/update", pageUpdate);
  server.on("/do_update", HTTP_POST, handleUpdateDone, handleUpdateUpload);
  server.onNotFound(notFound);
  server.begin();
  Serial.println("HTTP Server gestartet.");

  ArduinoOTA.setHostname(MDNS_HOST);
  ArduinoOTA.setPassword(OTA_ARDUINO_PASS);
  ArduinoOTA.onStart([]() { Serial.println("[OTA] Start"); });
  ArduinoOTA.onEnd([]()   { Serial.println("\n[OTA] Ende – Neustart..."); });
  ArduinoOTA.onProgress([](unsigned int progress, unsigned int total) {
    Serial.printf("[OTA] %u%%\r", progress * 100 / total);
  });
  ArduinoOTA.onError([](ota_error_t e) { Serial.printf("[OTA] Fehler[%u]\n", e); });
  ArduinoOTA.begin();
  Serial.println("[OTA] ArduinoOTA bereit.");
}

void loop(){
  server.handleClient();
  ArduinoOTA.handle();
  unsigned long now = millis();
  // Messung
  if(now - lastMeasure >= MEASURE_INTERVAL){
    lastMeasure = now;
    float d = measureDistance();
    // Plausibilitaet: Werte ausserhalb des kalibrierten Bereichs oder physikalisch
    // unmoegliche Spruenge verwerfen, bevor sie in die EMA einfliessen.
    bool plausible = !isnan(d);
    if (plausible && !isnan(d_leer) && !isnan(d_voll)) {
      float hiB = max(d_leer, d_voll) + 10.0f; // etwas Toleranz ueber "leer"
      float loB = min(d_leer, d_voll) - 10.0f; // und unter "voll"
      if (d > hiB || d < loB) plausible = false;
    }
    if (plausible && !isnan(lastDist) && fabsf(d - lastDist) > MAX_JUMP_CM)
      plausible = false; // Zisternenpegel aendert sich nicht meterweise in 2s
    if (plausible) {
      // EMA α=0.2: glättet Schwankungen, Zisternenpegel ändert sich langsam
      lastDist = isnan(lastDist) ? d : (0.2f * d + 0.8f * lastDist);
      lastPerc = computePercent(lastDist);
      volume   = calculateVolume(lastDist);
      lastGoodMeasure = now;
    } else if (lastGoodMeasure && (now - lastGoodMeasure > MEASURE_STALE_MS)) {
      // Sensor liefert zu lange nichts Brauchbares -> Anzeige nicht einfrieren
      lastDist = NAN; lastPerc = NAN; volume = NAN;
    }
    Serial.println("---------------------");
    Serial.print("Distance: ");
    Serial.println(d);
    Serial.print("Percent: ");
    Serial.println(lastPerc);
    Serial.print("Volumen: ");
    Serial.print(volume);
    Serial.println(" Liter");

    Serial.println("--- WiFi-Status ---");
    
    // STA-Status
    Serial.print("STA: ");
    switch(WiFi.status()) {
      case WL_CONNECTED: Serial.println("Verbunden (IP: " + WiFi.localIP().toString() + ")"); break;
      case WL_DISCONNECTED: Serial.println("Nicht verbunden"); break;
      case WL_NO_SSID_AVAIL: Serial.println("SSID nicht verfügbar"); break;
      case WL_CONNECT_FAILED: Serial.println("Verbindung fehlgeschlagen"); break;
      default: Serial.println("Unbekannter Status (" + String(WiFi.status()) + ")"); break;
    }
    
    // AP-Status
    Serial.print("AP: ");
    if(WiFi.getMode() == WIFI_AP_STA || WiFi.getMode() == WIFI_AP) {
      Serial.print("Aktiv (IP: " + WiFi.softAPIP().toString() + ", Clients: " + String(WiFi.softAPgetStationNum()) + ")");
    } else {
      Serial.print("Inaktiv");
    }
    Serial.println();    
  }
  // mDNS starten sobald STA-Verbindung steht (einmalig)
  if (WiFi.status() == WL_CONNECTED && !mdnsStarted) {
    Serial.println("[STA] Verbunden. IP: " + WiFi.localIP().toString());
    if (MDNS.begin(MDNS_HOST)) {
      MDNS.addService("http", "tcp", 80);
      Serial.println("[mDNS] http://" + String(MDNS_HOST) + ".local");
    } else {
      Serial.println("[mDNS] Start fehlgeschlagen");
    }
    mdnsStarted = true;
  }
  if (WiFi.status() != WL_CONNECTED && mdnsStarted) {
    mdnsStarted = false; // zurücksetzen damit mDNS nach Re-Connect neu startet
  }

  // STA-Retry alle 60 Sekunden falls nicht verbunden
  if (now - lastSTAcheck >= STA_RETRY_INTERVAL) {
    lastSTAcheck = now;
    if (staEnabled && WiFi.status() != WL_CONNECTED) {
      Serial.println("[STA] Nicht verbunden – neuer Versuch.");
      connectSTA();
    }
  }
  // AP in Grace Period sicherstellen
  if(now < apExpires){
    if(WiFi.getMode() != WIFI_AP_STA) WiFi.mode(WIFI_AP_STA);
    if(WiFi.softAPIP().toString() == "0.0.0.0"){
      WiFi.softAP(AP_SSID, AP_PASS);
      Serial.println("[AP] (Grace) sichergestellt.");
    }
  } else {
    if(WiFi.status() == WL_CONNECTED){
      if(WiFi.softAPgetStationNum() > 0 || WiFi.getMode() == WIFI_AP_STA){
        WiFi.softAPdisconnect(true);
        WiFi.mode(WIFI_STA);
        Serial.println("[AP] abgeschaltet nach erfolgreichem STA-Connect.");
      }
    } else {
      if(WiFi.getMode() != WIFI_AP_STA) WiFi.mode(WIFI_AP_STA);
      if(WiFi.softAPIP().toString() == "0.0.0.0"){
        WiFi.softAP(AP_SSID, AP_PASS);
        Serial.println("[AP] (Fallback) reaktiviert.");
      }
    }
  }

  // Automatische Update-Prüfung
  if (autoUpdateEnabled && WiFi.status() == WL_CONNECTED && now - lastOTACheck >= OTA_CHECK_INTERVAL) {
    lastOTACheck = now;
    checkAndApplyOTA();
  }

  // analoger Ausgang wenn aktiviert
  if(analogOutputEnabled && !isnan(lastPerc)){
    uint8_t dacVal = (uint8_t)round((lastPerc/100.0f)*255.0f);
    dacWrite(DAC_PIN, dacVal);
  } else {
    dacWrite(DAC_PIN, 0);
  }
}